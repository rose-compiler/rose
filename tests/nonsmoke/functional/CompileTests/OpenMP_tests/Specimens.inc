# we define various list of files to be used for testing OpenMP support

# removed experimental dist_data, mpi examples
#    axpy_ompacc_parseonly.c
#    axpy_ompacc_mpi.c
#    axpy_ompacc4.c 
# this is the all set of OpenMP C input tests
# all other C test lists can be a subset of this one
nonsmoke_specimens_openmp_c = \
    3loops.c \
    alignment.c \
    array_init_2.c \
    array_init.c \
    atomic.c \
    atoms-2.c \
    axpy_ompacc2.c \
    axpy_ompacc3.c \
    axpy_ompacc.c \
    barrier.c \
    bonds-2.c \
    collapse_2.c \
    collapse.c \
    copyin.c \
    copyprivate2.c \
    copyprivate3.c \
    copyprivate.c \
    critical.c \
    critical_dead.c \
    critical_orphaned.c \
    dijkstra_open_mp.c \
    dynamicChunk.c \
    empty.c \
    endif2.c \
    endif3.c \
    endif.c \
    expressions.c \
    falsesharing.c \
    firstlastprivate.c \
    firstPrivateArray_2.c \
    firstPrivateArray.c \
    firstprivate.c \
    flush.c \
    flush_exampleA_21_1c.c \
    full_verify.c \
    get_max_threads.c \
    hello-1.c \
    hello-2.c \
    hello.c \
    hello-ordered.c \
    include_header_only.c \
    init.c \
    jacobi.c \
    jacobi-collapse.c \
    jacobi-ompacc.c \
    jacobi-ompacc-multiGPU.c \
    jacobi-ompacc-opt1.c \
    jacobi-ompacc-opt2.c \
    jacobi-ompacc-v2.c \
    lastprivate0.c \
    lastprivate.c \
    lastprivateOrphaned.c \
    limits_threads.c \
    linebreak.c \
    lockarray.c \
    loop1.c \
    lu_factorization.c \
    macroCalls.c \
    macroIds.c \
    master.c \
    masterSingle.c \
    matrixmultiply.c \
    matrixmultiply-ompacc2.c \
    matrixmultiply-ompacc.c \
    matrix_vector.c \
    md_open_mp.c \
    multiple_return.c \
    nestedpar1.c \
    nestedpar.c \
    nowait.c \
    omp1.c \
    ompfor2.c \
    ompfor3.c \
    ompfor4.c \
    ompfor5.c \
    ompfor6.c \
    ompfor7.c \
    ompfor.c \
    ompfor_c99.c \
    ompfor-decremental.c \
    ompfor-default.c \
    ompfor-static.c \
    ompGetNumThreads.c \
    omp_sections.c \
    ordered2.c \
    ordered.c \
    orphaned-directives.c \
    parallel.c \
    parallelfor2.c \
    parallelfor.c \
    parallel-if.c \
    parallel-if-numthreads.c \
    parallel-numthreads.c \
    parallel-reduction2.c \
    parallel-reduction.c \
    parallelsections.c \
    preprocessingInfo.c \
    prettyfunc.c \
    private.c \
    private-duplicate.c \
    privatej.c \
    recursive.c \
    reduction2.c \
    reduction.c \
    reduction-classic.c \
    rice1.c \
    section1.c \
    section.c \
    set_num_threads.c \
    shared.c \
    single2.c \
    single.c \
    single_copyprivate.c \
    sizeof.c \
    spmd1.c \
    staticChunk.c \
    subteam2.c \
    subteam.c \
    task_array2.c \
    task_array.c \
    task_largenumber.c \
    task_orphaned.c \
    task_outlining.c \
    task_underIf.c \
    task_untied2.c \
    task_untied3.c \
    task_untied4.c \
    task_untied.c \
    task_wait2.c \
    task_wait.c \
    threadprivate2.c \
    threadprivate3.c \
    threadprivate.c \
    threadProcessor.c \
    twoRegions.c \
    upperCase.c \
    variables.c


# add all
# excluded for now: 
#    macroCalls.c TODO
# omp for with omp task, wrong testing interface for now?
nonsmoke_getDataSharingAttribute_c = \
    3loops.c \
    alignment.c \
    array_init_2.c \
    array_init.c \
    atomic.c \
    atoms-2.c \
    axpy_ompacc2.c \
    axpy_ompacc3.c \
    axpy_ompacc.c \
    barrier.c \
    bonds-2.c \
    collapse_2.c \
    collapse.c \
    copyin.c \
    copyprivate2.c \
    copyprivate3.c \
    copyprivate.c \
    critical.c \
    critical_dead.c \
    critical_orphaned.c \
    dijkstra_open_mp.c \
    dynamicChunk.c \
    empty.c \
    endif2.c \
    endif3.c \
    endif.c \
    expressions.c \
    falsesharing.c \
    firstlastprivate.c \
    firstPrivateArray_2.c \
    firstPrivateArray.c \
    firstprivate.c \
    flush.c \
    flush_exampleA_21_1c.c \
    full_verify.c \
    get_max_threads.c \
    hello-1.c \
    hello-2.c \
    hello.c \
    hello-ordered.c \
    include_header_only.c \
    init.c \
    jacobi.c \
    jacobi-collapse.c \
    jacobi-ompacc.c \
    jacobi-ompacc-multiGPU.c \
    jacobi-ompacc-opt1.c \
    jacobi-ompacc-opt2.c \
    jacobi-ompacc-v2.c \
    lastprivate0.c \
    lastprivate.c \
    lastprivateOrphaned.c \
    limits_threads.c \
    linebreak.c \
    lockarray.c \
    loop1.c \
    lu_factorization.c \
    macroIds.c \
    master.c \
    masterSingle.c \
    matrixmultiply.c \
    matrixmultiply-ompacc2.c \
    matrixmultiply-ompacc.c \
    matrix_vector.c \
    md_open_mp.c \
    multiple_return.c \
    nestedpar1.c \
    nestedpar.c \
    nowait.c \
    omp1.c \
    ompfor2.c \
    ompfor3.c \
    ompfor4.c \
    ompfor5.c \
    ompfor6.c \
    ompfor7.c \
    ompfor.c \
    ompfor_c99.c \
    ompfor-decremental.c \
    ompfor-default.c \
    ompfor-static.c \
    ompGetNumThreads.c \
    omp_sections.c \
    ordered2.c \
    ordered.c \
    orphaned-directives.c \
    parallel.c \
    parallelfor2.c \
    parallelfor.c \
    parallel-if.c \
    parallel-if-numthreads.c \
    parallel-numthreads.c \
    parallel-reduction2.c \
    parallel-reduction.c \
    parallelsections.c \
    preprocessingInfo.c \
    prettyfunc.c \
    private.c \
    private-duplicate.c \
    privatej.c \
    recursive.c \
    reduction2.c \
    reduction.c \
    reduction-classic.c \
    rice1.c \
    section1.c \
    section.c \
    set_num_threads.c \
    shared.c \
    single2.c \
    single.c \
    single_copyprivate.c \
    sizeof.c \
    spmd1.c \
    staticChunk.c \
    subteam2.c \
    subteam.c \
    task_array2.c \
    task_array.c \
    task_largenumber.c \
    task_orphaned.c \
    task_outlining.c \
    task_underIf.c \
    task_untied2.c \
    task_untied3.c \
    task_untied4.c \
    task_untied.c \
    task_wait2.c \
    task_wait.c \
    threadprivate2.c \
    threadprivate3.c \
    threadprivate.c \
    threadProcessor.c \
    twoRegions.c \
    upperCase.c \
    variables.c

nonsmoke_getDataSharingAttribute_c_verify = \
    3loops.c \
    alignment.c \
    array_init_2.c \
    array_init.c \
    atomic.c \
    atoms-2.c \
    axpy_ompacc2.c \
    axpy_ompacc3.c \
    axpy_ompacc.c \
    barrier.c \
    bonds-2.c \
    collapse_2.c \
    collapse.c \
    copyin.c \
    copyprivate2.c \
    copyprivate3.c \
    copyprivate.c \
    critical.c \
    critical_dead.c \
    critical_orphaned.c \
    dijkstra_open_mp.c \
    dynamicChunk.c \
    empty.c \
    endif2.c \
    endif3.c \
    endif.c
 

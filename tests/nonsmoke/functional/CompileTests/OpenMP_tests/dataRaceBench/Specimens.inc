# TODO failing tests

dataracebench_c_files = \
3mm-tile-no.c \
adi-tile-no.c \
3mm-parallel-no.c \
adi-parallel-no.c \
antidep1-orig-yes.c \
antidep1-var-yes.c \
antidep2-orig-yes.c \
antidep2-var-yes.c \
doall1-orig-no.c \
doall2-orig-no.c \
doall2-orig-yes.c \
doallchar-orig-no.c \
firstprivate-orig-no.c \
flush-orig-no.c \
flush-orig-yes.c \
fprintf-orig-no.c \
functionparameter-orig-no.c \
getthreadnum-orig-no.c \
getthreadnum-orig-yes.c \
indirectaccess1-orig-yes.c \
indirectaccess2-orig-yes.c \
indirectaccess3-orig-yes.c \
indirectaccess4-orig-yes.c \
indirectaccesssharebase-orig-no.c \
inneronly1-orig-no.c \
inneronly2-orig-no.c \
jacobi2d-parallel-no.c \
jacobi2d-tile-no.c \
jacobiinitialize-orig-no.c \
jacobikernel-orig-no.c \
lastprivatemissing-orig-yes.c \
lastprivatemissing-var-yes.c \
lastprivate-orig-no.c \
matrixmultiply-orig-no.c \
matrixvector1-orig-no.c \
matrixvector2-orig-no.c \
minusminus-orig-yes.c \
minusminus-var-yes.c \
nowait-orig-yes.c \
outeronly1-orig-no.c \
outeronly2-orig-no.c \
outofbounds-orig-yes.c \
outofbounds-var-yes.c \
outputdep-orig-yes.c \
outputdep-var-yes.c \
pireduction-orig-no.c \
plusplus-orig-yes.c \
plusplus-var-yes.c \
pointernoaliasing-orig-no.c \
privatemissing-orig-yes.c \
privatemissing-var-yes.c \
reductionmissing-orig-yes.c \
reductionmissing-var-yes.c \
restrictpointer1-orig-no.c \
restrictpointer2-orig-no.c \
sections1-orig-yes.c \
sectionslock1-orig-no.c \
simd1-orig-no.c \
simdtruedep-orig-yes.c \
simdtruedep-var-yes.c \
single-orig-no.c \
targetparallelfor-orig-no.c \
targetparallelfor-orig-yes.c \
taskdep1-orig-no.c \
taskdep2-orig-no.c \
taskdep3-orig-no.c \
taskdependmissing-orig-yes.c \
truedep1-orig-yes.c \
truedep1-var-yes.c \
truedepfirstdimension-orig-yes.c \
truedepfirstdimension-var-yes.c \
truedeplinear-orig-yes.c \
truedeplinear-var-yes.c \
truedepscalar-orig-yes.c \
truedepscalar-var-yes.c \
truedepseconddimension-orig-yes.c \
truedepseconddimension-var-yes.c \
truedepsingleelement-orig-yes.c \
truedepsingleelement-var-yes.c \
2018-simd2-orig-no.c \
2018-parallel-for-simd-orig-no.c

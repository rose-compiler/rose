# define various sets of C files as input for other tests
nonsmoke_genericCoverage_c= \
    helloworld.cpp

# PP 17/05- not sure if the tests below work on all - non-gcc - backend compilers
#   longFile.C 
#   test2006_172.C

# PP 17/05 The tests below will not work on older gcc backend compilers.
#    test2014_158.C 
#    test2014_237.C 
#    test2016_90.C


# verify all for now
nonsmoke_genericCoverage_c_verify=$(nonsmoke_genericCoverage_c)

# C++ tests 
nonsmoke_almost_all_cpp = \
   test2017_14_Liao.C

almost_all_cpp = \
   test2013_253.C \
   test2013_255.C \
   test2013_256.C \
   test2013_258.C \
   test2013_259.C \
   test2013_261.C \
   test2013_271.C \
   test2013_272.C \
   test2013_273.C \
   test2013_274.C \
   test2013_275.C \
   test2013_276.C \
   test2013_277.C \
   test2013_278.C \
   test2013_279.C \
   test2013_280.C \
   test2013_281.C \
   test2013_282.C \
   test2013_283.C \
   test2013_284.C \
   test2013_285.C \
   test2013_286.C \
   test2013_287.C \
   test2013_288.C \
   test2013_289.C \
   test2013_290.C \
   test2013_291.C \
   test2013_292.C \
   test2013_293.C \
   test2013_294.C \
   test2013_295.C \
   test2013_296.C \
   test2014_01.C \
   test2014_02.C \
   test2014_03.C \
   test2014_04.C \
   test2014_05.C \
   test2014_06.C \
   test2014_07.C \
   test2014_08.C \
   test2014_09.C \
   test2014_10.C \
   test2014_11.C \
   test2014_12.C \
   test2014_13.C \
   test2014_16.C \
   test2014_17.C \
   test2014_18.C \
   test2014_19.C \
   test2014_20.C \
   test2014_21.C \
   test2014_24.C \
   test2014_26.C \
   test2014_27.C \
   test2014_28.C \
   test2014_29.C \
   test2014_30.C \
   test2014_31.C \
   test2014_32.C \
   test2014_33.C \
   test2014_34.C \
   test2014_35.C \
   test2014_36.C \
   test2014_37.C \
   test2014_38.C \
   test2014_39.C \
   test2014_40.C \
   test2014_41.C \
   test2014_43.C \
   test2014_45.C \
   test2014_47.C \
   test2014_48.C \
   test2014_49.C \
   test2014_50.C \
   test2014_53.C \
   test2014_54.C \
   test2014_55.C \
   test2014_56.C \
   test2014_57.C \
   test2014_58.C \
   test2014_60.C \
   test2014_61.C \
   test2014_62.C \
   test2014_67.C \
   test2014_68.C \
   test2014_70.C \
   test2014_72.C \
   test2014_73.C \
   test2014_74.C \
   test2014_75.C \
   test2013_117.C \
   test2014_79.C \
   test2014_80.C \
   test2014_82.C \
   test2014_83.C \
   test2014_84.C \
   test2014_85.C \
   test2014_86.C \
   test2014_87.C \
   test2014_88.C \
   test2014_89.C \
   test2014_90.C \
   test2014_91.C \
   test2014_92.C \
   test2014_93.C \
   test2014_94.C \
   test2014_95.C \
   test2014_96.C \
   test2014_97.C \
   test2014_98.C \
   test2014_99.C \
   test2014_100.C \
   test2014_101.C \
   test2014_102.C \
   test2014_107.C \
   test2014_108.C \
   test2014_109.C \
   test2014_112.C \
   test2014_114.C \
   test2014_115.C \
   test2014_116.C \
   test2014_117.C \
   test2014_118.C \
   test2014_119.C \
   test2014_120.C \
   test2014_121.C \
   test2014_122.C \
   test2014_123.C \
   test2014_124.C \
   test2014_125.C \
   test2014_126.C \
   test2014_127.C \
   test2014_128.C \
   test2014_129.C \
   test2014_130.C \
   test2014_131.C \
   test2014_132.C \
   test2014_133.C \
   test2014_134.C \
   test2014_135.C \
   test2014_136.C \
   test2014_137.C \
   test2014_139.C \
   test2014_140.C \
   test2014_141.C \
   test2014_142.C \
   test2014_143.C \
   test2014_144.C \
   test2014_145.C \
   test2014_146.C \
   test2014_147.C \
   test2014_148.C \
   test2014_149.C \
   test2014_150.C \
   test2014_151.C \
   test2014_152.C \
   test2014_153.C \
   test2014_154.C \
   test2014_155.C \
   test2014_156.C \
   test2014_157.C \
   test2014_160.C \
   test2014_161.C \
   test2014_162.C \
   test2014_163.C \
   test2014_165.C \
   test2014_166.C \
   test2014_167.C \
   test2014_168.C \
   test2014_169.C \
   test2014_170.C \
   test2014_171.C \
   test2014_172.C \
   test2014_174.C \
   test2014_176.C \
   test2014_177.C \
   test2014_178.C \
   test2014_179.C \
   test2014_182.C \
   test2014_183.C \
   test2014_184.C \
   test2014_185.C \
   test2014_186.C \
   test2014_189.C \
   test2014_190.C \
   test2014_191.C \
   test2014_192.C \
   test2014_193.C \
   test2014_194.C \
   test2014_195.C \
   test2014_196.C \
   test2014_197.C \
   test2014_198.C \
   test2014_199.C \
   test2014_200.C \
   test2014_201.C \
   test2014_202.C \
   test2014_203.C \
   test2014_204.C \
   test2014_205.C \
   test2014_206.C \
   test2014_207.C \
   test2014_208.C \
   test2014_209.C \
   test2014_210.C \
   test2014_212.C \
   test2014_215.C \
   test2014_216.C \
   test2014_217.C \
   test2014_218.C \
   test2014_219.C \
   test2014_220.C \
   test2014_221.C \
   test2014_222.C \
   test2014_223.C \
   test2014_224.C \
   test2014_225.C \
   test2014_226.C \
   test2014_226.C \
   test2014_226.C \
   test2014_226.C \
   test2014_230.C \
   test2014_231.C \
   test2014_232.C \
   test2014_233.C \
   test2014_234.C \
   test2014_235.C \
   test2014_239.C \
   test2014_240.C \
   test2014_241.C \
   test2014_242.C \
   test2014_243.C \
   test2015_01.C \
   test2015_02.C \
   test2015_03.C \
   test2015_04.C \
   test2015_05.C \
   test2015_07.C \
   test2015_08.C \
   test2015_09.C \
   test2015_20.C \
   test2015_21.C \
   test2015_22.C \
   test2015_24.C \
   test2015_26.C \
   test2015_27.C \
   test2015_28.C \
   test2015_29.C \
   test2015_32.C \
   test2015_33.C \
   test2015_34.C \
   test2015_35.C \
   test2015_36.C \
   test2015_40.C \
   test2015_43.C \
   test2015_44.C \
   test2015_45.C \
   test2015_50.C \
   test2015_52.C \
   test2015_57.C \
   test2015_58.C \
   test2015_59.C \
   test2015_60.C \
   test2015_61.C \
   test2015_76.C \
   test2015_77.C \
   test2015_78.C \
   test2015_79.C \
   test2015_80.C \
   test2015_97.C \
   lulesh.C \
   luleshTALC.C \
   Area-01.C \
   $(NEW_TESTCODES)

# DQ (11/13/2015): Added test codes:
NEW_TESTCODES = \
   test2015_85.C \
   test2015_86.C \
   test2015_88.C \
   test2015_89.C \
   test2015_99.C \
   test2015_100.C \
   test2015_101.C \
   test2015_102.C \
   test2015_103.C \
   test2015_104.C \
   test2015_106.C \
   test2015_107.C \
   test2015_108.C \
   test2015_110.C \
   test2015_111.C \
   test2015_112.C \
   test2015_113.C \
   test2015_114.C \
   test2015_117.C \
   test2015_118.C \
   test2015_119.C \
   test2015_121.C \
   test2015_122.C \
   test2015_123.C \
   test2015_124.C \
   test2015_125.C \
   test2015_128.C \
   test2015_130.C \
   test2015_131.C \
   test2015_132.C \
   test2015_133.C \
   test2015_134.C \
   test2015_137.C \
   test2015_138.C \
   test2015_139.C \
   test2015_140.C \
   test2015_141.C \
   test2015_142.C \
   test2015_143.C \
   test2015_144.C \
   test2015_145.C \
   test2015_146.C \
   test2015_147.C \
   test2015_149.C \
   test2015_150.C \
   test2015_151.C \
   test2015_152.C \
   test2015_153.C \
   test2015_154.C \
   test2016_01.C \
   test2016_02.C \
   test2016_03.C \
   test2016_04.C \
   test2016_05.C \
   test2016_06.C \
   test2016_07.C \
   test2016_08.C \
   test2016_09.C \
   test2016_10.C \
   test2016_11.C \
   test2016_12.C \
   test2016_13.C \
   test2016_14.C \
   test2016_19.C \
   test2016_21.C \
   test2016_25.C \
   test2016_26.C \
   test2016_27.C \
   test2016_28.C \
   test2016_29.C \
   test2016_30.C \
   test2016_31.C \
   test2016_32.C \
   test2016_33.C \
   test2016_34.C \
   test2016_36.C \
   test2016_38.C \
   test2016_40.C \
   test2016_41.C \
   test2016_42.C \
   test2016_43.C \
   test2016_44.C \
   test2016_45.C \
   test2016_46.C \
   test2016_47.C \
   test2016_48.C \
   test2016_49.C \
   test2016_50.C \
   test2016_51.C \
   test2016_52.C \
   test2016_53.C \
   test2016_54.C \
   test2016_55.C \
   test2016_56.C \
   test2016_57.C \
   test2016_59.C \
   test2016_60.C \
   test2016_61.C \
   test2016_62.C \
   test2016_63.C \
   test2016_64.C \
   test2016_65.C \
   test2016_66.C \
   test2016_67.C \
   test2016_68.C \
   test2016_69.C \
   test2016_70.C \
   test2016_80.C \
   test2016_81.C \
   test2016_83.C \
   test2016_85.C \
   test2016_86.C \
   test2016_87.C \
   test2016_88.C \
   test2016_91.C \
   test2016_93.C \
   test2017_04.C \
   test2017_09.C \
   test2017_10.C \
   test2017_11.C

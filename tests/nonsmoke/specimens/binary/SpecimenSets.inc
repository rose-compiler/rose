# Collections of binary specimens                    -*- makefile -*-
# This file is automatically generated by running
#   $ make build-SpecimenSets.inc
# in the $ROSE_BLD/tests/nonsmoke/specimens/binary directory

include $(top_srcdir)/tests/nonsmoke/specimens/binary/Specimens.inc

# Container agnostic
nonsmoke_specimens_binary_any_exe_amd64 = $(nonsmoke_specimens_binary_dos_exe_amd64) $(nonsmoke_specimens_binary_elf_exe_amd64) $(nonsmoke_specimens_binary_pe_exe_amd64) $(nonsmoke_specimens_binary_raw_exe_amd64)
nonsmoke_specimens_binary_any_exe_arm = $(nonsmoke_specimens_binary_dos_exe_arm) $(nonsmoke_specimens_binary_elf_exe_arm) $(nonsmoke_specimens_binary_pe_exe_arm) $(nonsmoke_specimens_binary_raw_exe_arm)
nonsmoke_specimens_binary_any_exe_mips = $(nonsmoke_specimens_binary_dos_exe_mips) $(nonsmoke_specimens_binary_elf_exe_mips) $(nonsmoke_specimens_binary_pe_exe_mips) $(nonsmoke_specimens_binary_raw_exe_mips)
nonsmoke_specimens_binary_any_exe_m68k = $(nonsmoke_specimens_binary_dos_exe_m68k) $(nonsmoke_specimens_binary_elf_exe_m68k) $(nonsmoke_specimens_binary_pe_exe_m68k) $(nonsmoke_specimens_binary_raw_exe_m68k)
nonsmoke_specimens_binary_any_exe_ppc = $(nonsmoke_specimens_binary_dos_exe_ppc) $(nonsmoke_specimens_binary_elf_exe_ppc) $(nonsmoke_specimens_binary_pe_exe_ppc) $(nonsmoke_specimens_binary_raw_exe_ppc)
nonsmoke_specimens_binary_any_exe_x86 = $(nonsmoke_specimens_binary_dos_exe_x86) $(nonsmoke_specimens_binary_elf_exe_x86) $(nonsmoke_specimens_binary_pe_exe_x86) $(nonsmoke_specimens_binary_raw_exe_x86)
nonsmoke_specimens_binary_any_obj_amd64 = $(nonsmoke_specimens_binary_dos_obj_amd64) $(nonsmoke_specimens_binary_elf_obj_amd64) $(nonsmoke_specimens_binary_pe_obj_amd64) $(nonsmoke_specimens_binary_raw_obj_amd64)
nonsmoke_specimens_binary_any_obj_arm = $(nonsmoke_specimens_binary_dos_obj_arm) $(nonsmoke_specimens_binary_elf_obj_arm) $(nonsmoke_specimens_binary_pe_obj_arm) $(nonsmoke_specimens_binary_raw_obj_arm)
nonsmoke_specimens_binary_any_obj_mips = $(nonsmoke_specimens_binary_dos_obj_mips) $(nonsmoke_specimens_binary_elf_obj_mips) $(nonsmoke_specimens_binary_pe_obj_mips) $(nonsmoke_specimens_binary_raw_obj_mips)
nonsmoke_specimens_binary_any_obj_m68k = $(nonsmoke_specimens_binary_dos_obj_m68k) $(nonsmoke_specimens_binary_elf_obj_m68k) $(nonsmoke_specimens_binary_pe_obj_m68k) $(nonsmoke_specimens_binary_raw_obj_m68k)
nonsmoke_specimens_binary_any_obj_ppc = $(nonsmoke_specimens_binary_dos_obj_ppc) $(nonsmoke_specimens_binary_elf_obj_ppc) $(nonsmoke_specimens_binary_pe_obj_ppc) $(nonsmoke_specimens_binary_raw_obj_ppc)
nonsmoke_specimens_binary_any_obj_x86 = $(nonsmoke_specimens_binary_dos_obj_x86) $(nonsmoke_specimens_binary_elf_obj_x86) $(nonsmoke_specimens_binary_pe_obj_x86) $(nonsmoke_specimens_binary_raw_obj_x86)
nonsmoke_specimens_binary_any_archive_amd64 = $(nonsmoke_specimens_binary_dos_archive_amd64) $(nonsmoke_specimens_binary_elf_archive_amd64) $(nonsmoke_specimens_binary_pe_archive_amd64) $(nonsmoke_specimens_binary_raw_archive_amd64)
nonsmoke_specimens_binary_any_archive_arm = $(nonsmoke_specimens_binary_dos_archive_arm) $(nonsmoke_specimens_binary_elf_archive_arm) $(nonsmoke_specimens_binary_pe_archive_arm) $(nonsmoke_specimens_binary_raw_archive_arm)
nonsmoke_specimens_binary_any_archive_mips = $(nonsmoke_specimens_binary_dos_archive_mips) $(nonsmoke_specimens_binary_elf_archive_mips) $(nonsmoke_specimens_binary_pe_archive_mips) $(nonsmoke_specimens_binary_raw_archive_mips)
nonsmoke_specimens_binary_any_archive_m68k = $(nonsmoke_specimens_binary_dos_archive_m68k) $(nonsmoke_specimens_binary_elf_archive_m68k) $(nonsmoke_specimens_binary_pe_archive_m68k) $(nonsmoke_specimens_binary_raw_archive_m68k)
nonsmoke_specimens_binary_any_archive_ppc = $(nonsmoke_specimens_binary_dos_archive_ppc) $(nonsmoke_specimens_binary_elf_archive_ppc) $(nonsmoke_specimens_binary_pe_archive_ppc) $(nonsmoke_specimens_binary_raw_archive_ppc)
nonsmoke_specimens_binary_any_archive_x86 = $(nonsmoke_specimens_binary_dos_archive_x86) $(nonsmoke_specimens_binary_elf_archive_x86) $(nonsmoke_specimens_binary_pe_archive_x86) $(nonsmoke_specimens_binary_raw_archive_x86)
nonsmoke_specimens_binary_any_so_amd64 = $(nonsmoke_specimens_binary_dos_so_amd64) $(nonsmoke_specimens_binary_elf_so_amd64) $(nonsmoke_specimens_binary_pe_so_amd64) $(nonsmoke_specimens_binary_raw_so_amd64)
nonsmoke_specimens_binary_any_so_arm = $(nonsmoke_specimens_binary_dos_so_arm) $(nonsmoke_specimens_binary_elf_so_arm) $(nonsmoke_specimens_binary_pe_so_arm) $(nonsmoke_specimens_binary_raw_so_arm)
nonsmoke_specimens_binary_any_so_mips = $(nonsmoke_specimens_binary_dos_so_mips) $(nonsmoke_specimens_binary_elf_so_mips) $(nonsmoke_specimens_binary_pe_so_mips) $(nonsmoke_specimens_binary_raw_so_mips)
nonsmoke_specimens_binary_any_so_m68k = $(nonsmoke_specimens_binary_dos_so_m68k) $(nonsmoke_specimens_binary_elf_so_m68k) $(nonsmoke_specimens_binary_pe_so_m68k) $(nonsmoke_specimens_binary_raw_so_m68k)
nonsmoke_specimens_binary_any_so_ppc = $(nonsmoke_specimens_binary_dos_so_ppc) $(nonsmoke_specimens_binary_elf_so_ppc) $(nonsmoke_specimens_binary_pe_so_ppc) $(nonsmoke_specimens_binary_raw_so_ppc)
nonsmoke_specimens_binary_any_so_x86 = $(nonsmoke_specimens_binary_dos_so_x86) $(nonsmoke_specimens_binary_elf_so_x86) $(nonsmoke_specimens_binary_pe_so_x86) $(nonsmoke_specimens_binary_raw_so_x86)
nonsmoke_specimens_binary_any_core_amd64 = $(nonsmoke_specimens_binary_dos_core_amd64) $(nonsmoke_specimens_binary_elf_core_amd64) $(nonsmoke_specimens_binary_pe_core_amd64) $(nonsmoke_specimens_binary_raw_core_amd64)
nonsmoke_specimens_binary_any_core_arm = $(nonsmoke_specimens_binary_dos_core_arm) $(nonsmoke_specimens_binary_elf_core_arm) $(nonsmoke_specimens_binary_pe_core_arm) $(nonsmoke_specimens_binary_raw_core_arm)
nonsmoke_specimens_binary_any_core_mips = $(nonsmoke_specimens_binary_dos_core_mips) $(nonsmoke_specimens_binary_elf_core_mips) $(nonsmoke_specimens_binary_pe_core_mips) $(nonsmoke_specimens_binary_raw_core_mips)
nonsmoke_specimens_binary_any_core_m68k = $(nonsmoke_specimens_binary_dos_core_m68k) $(nonsmoke_specimens_binary_elf_core_m68k) $(nonsmoke_specimens_binary_pe_core_m68k) $(nonsmoke_specimens_binary_raw_core_m68k)
nonsmoke_specimens_binary_any_core_ppc = $(nonsmoke_specimens_binary_dos_core_ppc) $(nonsmoke_specimens_binary_elf_core_ppc) $(nonsmoke_specimens_binary_pe_core_ppc) $(nonsmoke_specimens_binary_raw_core_ppc)
nonsmoke_specimens_binary_any_core_x86 = $(nonsmoke_specimens_binary_dos_core_x86) $(nonsmoke_specimens_binary_elf_core_x86) $(nonsmoke_specimens_binary_pe_core_x86) $(nonsmoke_specimens_binary_raw_core_x86)
nonsmoke_specimens_binary_any_insns_amd64 = $(nonsmoke_specimens_binary_dos_insns_amd64) $(nonsmoke_specimens_binary_elf_insns_amd64) $(nonsmoke_specimens_binary_pe_insns_amd64) $(nonsmoke_specimens_binary_raw_insns_amd64)
nonsmoke_specimens_binary_any_insns_arm = $(nonsmoke_specimens_binary_dos_insns_arm) $(nonsmoke_specimens_binary_elf_insns_arm) $(nonsmoke_specimens_binary_pe_insns_arm) $(nonsmoke_specimens_binary_raw_insns_arm)
nonsmoke_specimens_binary_any_insns_mips = $(nonsmoke_specimens_binary_dos_insns_mips) $(nonsmoke_specimens_binary_elf_insns_mips) $(nonsmoke_specimens_binary_pe_insns_mips) $(nonsmoke_specimens_binary_raw_insns_mips)
nonsmoke_specimens_binary_any_insns_m68k = $(nonsmoke_specimens_binary_dos_insns_m68k) $(nonsmoke_specimens_binary_elf_insns_m68k) $(nonsmoke_specimens_binary_pe_insns_m68k) $(nonsmoke_specimens_binary_raw_insns_m68k)
nonsmoke_specimens_binary_any_insns_ppc = $(nonsmoke_specimens_binary_dos_insns_ppc) $(nonsmoke_specimens_binary_elf_insns_ppc) $(nonsmoke_specimens_binary_pe_insns_ppc) $(nonsmoke_specimens_binary_raw_insns_ppc)
nonsmoke_specimens_binary_any_insns_x86 = $(nonsmoke_specimens_binary_dos_insns_x86) $(nonsmoke_specimens_binary_elf_insns_x86) $(nonsmoke_specimens_binary_pe_insns_x86) $(nonsmoke_specimens_binary_raw_insns_x86)
nonsmoke_specimens_binary_any_rot13_amd64 = $(nonsmoke_specimens_binary_dos_rot13_amd64) $(nonsmoke_specimens_binary_elf_rot13_amd64) $(nonsmoke_specimens_binary_pe_rot13_amd64) $(nonsmoke_specimens_binary_raw_rot13_amd64)
nonsmoke_specimens_binary_any_rot13_arm = $(nonsmoke_specimens_binary_dos_rot13_arm) $(nonsmoke_specimens_binary_elf_rot13_arm) $(nonsmoke_specimens_binary_pe_rot13_arm) $(nonsmoke_specimens_binary_raw_rot13_arm)
nonsmoke_specimens_binary_any_rot13_mips = $(nonsmoke_specimens_binary_dos_rot13_mips) $(nonsmoke_specimens_binary_elf_rot13_mips) $(nonsmoke_specimens_binary_pe_rot13_mips) $(nonsmoke_specimens_binary_raw_rot13_mips)
nonsmoke_specimens_binary_any_rot13_m68k = $(nonsmoke_specimens_binary_dos_rot13_m68k) $(nonsmoke_specimens_binary_elf_rot13_m68k) $(nonsmoke_specimens_binary_pe_rot13_m68k) $(nonsmoke_specimens_binary_raw_rot13_m68k)
nonsmoke_specimens_binary_any_rot13_ppc = $(nonsmoke_specimens_binary_dos_rot13_ppc) $(nonsmoke_specimens_binary_elf_rot13_ppc) $(nonsmoke_specimens_binary_pe_rot13_ppc) $(nonsmoke_specimens_binary_raw_rot13_ppc)
nonsmoke_specimens_binary_any_rot13_x86 = $(nonsmoke_specimens_binary_dos_rot13_x86) $(nonsmoke_specimens_binary_elf_rot13_x86) $(nonsmoke_specimens_binary_pe_rot13_x86) $(nonsmoke_specimens_binary_raw_rot13_x86)

# Filetype agnostic
nonsmoke_specimens_binary_dos_any_amd64 = $(nonsmoke_specimens_binary_dos_exe_amd64) $(nonsmoke_specimens_binary_dos_obj_amd64) $(nonsmoke_specimens_binary_dos_archive_amd64) $(nonsmoke_specimens_binary_dos_so_amd64) $(nonsmoke_specimens_binary_dos_core_amd64) $(nonsmoke_specimens_binary_dos_insns_amd64) $(nonsmoke_specimens_binary_dos_rot13_amd64)
nonsmoke_specimens_binary_dos_any_arm = $(nonsmoke_specimens_binary_dos_exe_arm) $(nonsmoke_specimens_binary_dos_obj_arm) $(nonsmoke_specimens_binary_dos_archive_arm) $(nonsmoke_specimens_binary_dos_so_arm) $(nonsmoke_specimens_binary_dos_core_arm) $(nonsmoke_specimens_binary_dos_insns_arm) $(nonsmoke_specimens_binary_dos_rot13_arm)
nonsmoke_specimens_binary_dos_any_mips = $(nonsmoke_specimens_binary_dos_exe_mips) $(nonsmoke_specimens_binary_dos_obj_mips) $(nonsmoke_specimens_binary_dos_archive_mips) $(nonsmoke_specimens_binary_dos_so_mips) $(nonsmoke_specimens_binary_dos_core_mips) $(nonsmoke_specimens_binary_dos_insns_mips) $(nonsmoke_specimens_binary_dos_rot13_mips)
nonsmoke_specimens_binary_dos_any_m68k = $(nonsmoke_specimens_binary_dos_exe_m68k) $(nonsmoke_specimens_binary_dos_obj_m68k) $(nonsmoke_specimens_binary_dos_archive_m68k) $(nonsmoke_specimens_binary_dos_so_m68k) $(nonsmoke_specimens_binary_dos_core_m68k) $(nonsmoke_specimens_binary_dos_insns_m68k) $(nonsmoke_specimens_binary_dos_rot13_m68k)
nonsmoke_specimens_binary_dos_any_ppc = $(nonsmoke_specimens_binary_dos_exe_ppc) $(nonsmoke_specimens_binary_dos_obj_ppc) $(nonsmoke_specimens_binary_dos_archive_ppc) $(nonsmoke_specimens_binary_dos_so_ppc) $(nonsmoke_specimens_binary_dos_core_ppc) $(nonsmoke_specimens_binary_dos_insns_ppc) $(nonsmoke_specimens_binary_dos_rot13_ppc)
nonsmoke_specimens_binary_dos_any_x86 = $(nonsmoke_specimens_binary_dos_exe_x86) $(nonsmoke_specimens_binary_dos_obj_x86) $(nonsmoke_specimens_binary_dos_archive_x86) $(nonsmoke_specimens_binary_dos_so_x86) $(nonsmoke_specimens_binary_dos_core_x86) $(nonsmoke_specimens_binary_dos_insns_x86) $(nonsmoke_specimens_binary_dos_rot13_x86)
nonsmoke_specimens_binary_elf_any_amd64 = $(nonsmoke_specimens_binary_elf_exe_amd64) $(nonsmoke_specimens_binary_elf_obj_amd64) $(nonsmoke_specimens_binary_elf_archive_amd64) $(nonsmoke_specimens_binary_elf_so_amd64) $(nonsmoke_specimens_binary_elf_core_amd64) $(nonsmoke_specimens_binary_elf_insns_amd64) $(nonsmoke_specimens_binary_elf_rot13_amd64)
nonsmoke_specimens_binary_elf_any_arm = $(nonsmoke_specimens_binary_elf_exe_arm) $(nonsmoke_specimens_binary_elf_obj_arm) $(nonsmoke_specimens_binary_elf_archive_arm) $(nonsmoke_specimens_binary_elf_so_arm) $(nonsmoke_specimens_binary_elf_core_arm) $(nonsmoke_specimens_binary_elf_insns_arm) $(nonsmoke_specimens_binary_elf_rot13_arm)
nonsmoke_specimens_binary_elf_any_mips = $(nonsmoke_specimens_binary_elf_exe_mips) $(nonsmoke_specimens_binary_elf_obj_mips) $(nonsmoke_specimens_binary_elf_archive_mips) $(nonsmoke_specimens_binary_elf_so_mips) $(nonsmoke_specimens_binary_elf_core_mips) $(nonsmoke_specimens_binary_elf_insns_mips) $(nonsmoke_specimens_binary_elf_rot13_mips)
nonsmoke_specimens_binary_elf_any_m68k = $(nonsmoke_specimens_binary_elf_exe_m68k) $(nonsmoke_specimens_binary_elf_obj_m68k) $(nonsmoke_specimens_binary_elf_archive_m68k) $(nonsmoke_specimens_binary_elf_so_m68k) $(nonsmoke_specimens_binary_elf_core_m68k) $(nonsmoke_specimens_binary_elf_insns_m68k) $(nonsmoke_specimens_binary_elf_rot13_m68k)
nonsmoke_specimens_binary_elf_any_ppc = $(nonsmoke_specimens_binary_elf_exe_ppc) $(nonsmoke_specimens_binary_elf_obj_ppc) $(nonsmoke_specimens_binary_elf_archive_ppc) $(nonsmoke_specimens_binary_elf_so_ppc) $(nonsmoke_specimens_binary_elf_core_ppc) $(nonsmoke_specimens_binary_elf_insns_ppc) $(nonsmoke_specimens_binary_elf_rot13_ppc)
nonsmoke_specimens_binary_elf_any_x86 = $(nonsmoke_specimens_binary_elf_exe_x86) $(nonsmoke_specimens_binary_elf_obj_x86) $(nonsmoke_specimens_binary_elf_archive_x86) $(nonsmoke_specimens_binary_elf_so_x86) $(nonsmoke_specimens_binary_elf_core_x86) $(nonsmoke_specimens_binary_elf_insns_x86) $(nonsmoke_specimens_binary_elf_rot13_x86)
nonsmoke_specimens_binary_pe_any_amd64 = $(nonsmoke_specimens_binary_pe_exe_amd64) $(nonsmoke_specimens_binary_pe_obj_amd64) $(nonsmoke_specimens_binary_pe_archive_amd64) $(nonsmoke_specimens_binary_pe_so_amd64) $(nonsmoke_specimens_binary_pe_core_amd64) $(nonsmoke_specimens_binary_pe_insns_amd64) $(nonsmoke_specimens_binary_pe_rot13_amd64)
nonsmoke_specimens_binary_pe_any_arm = $(nonsmoke_specimens_binary_pe_exe_arm) $(nonsmoke_specimens_binary_pe_obj_arm) $(nonsmoke_specimens_binary_pe_archive_arm) $(nonsmoke_specimens_binary_pe_so_arm) $(nonsmoke_specimens_binary_pe_core_arm) $(nonsmoke_specimens_binary_pe_insns_arm) $(nonsmoke_specimens_binary_pe_rot13_arm)
nonsmoke_specimens_binary_pe_any_mips = $(nonsmoke_specimens_binary_pe_exe_mips) $(nonsmoke_specimens_binary_pe_obj_mips) $(nonsmoke_specimens_binary_pe_archive_mips) $(nonsmoke_specimens_binary_pe_so_mips) $(nonsmoke_specimens_binary_pe_core_mips) $(nonsmoke_specimens_binary_pe_insns_mips) $(nonsmoke_specimens_binary_pe_rot13_mips)
nonsmoke_specimens_binary_pe_any_m68k = $(nonsmoke_specimens_binary_pe_exe_m68k) $(nonsmoke_specimens_binary_pe_obj_m68k) $(nonsmoke_specimens_binary_pe_archive_m68k) $(nonsmoke_specimens_binary_pe_so_m68k) $(nonsmoke_specimens_binary_pe_core_m68k) $(nonsmoke_specimens_binary_pe_insns_m68k) $(nonsmoke_specimens_binary_pe_rot13_m68k)
nonsmoke_specimens_binary_pe_any_ppc = $(nonsmoke_specimens_binary_pe_exe_ppc) $(nonsmoke_specimens_binary_pe_obj_ppc) $(nonsmoke_specimens_binary_pe_archive_ppc) $(nonsmoke_specimens_binary_pe_so_ppc) $(nonsmoke_specimens_binary_pe_core_ppc) $(nonsmoke_specimens_binary_pe_insns_ppc) $(nonsmoke_specimens_binary_pe_rot13_ppc)
nonsmoke_specimens_binary_pe_any_x86 = $(nonsmoke_specimens_binary_pe_exe_x86) $(nonsmoke_specimens_binary_pe_obj_x86) $(nonsmoke_specimens_binary_pe_archive_x86) $(nonsmoke_specimens_binary_pe_so_x86) $(nonsmoke_specimens_binary_pe_core_x86) $(nonsmoke_specimens_binary_pe_insns_x86) $(nonsmoke_specimens_binary_pe_rot13_x86)
nonsmoke_specimens_binary_raw_any_amd64 = $(nonsmoke_specimens_binary_raw_exe_amd64) $(nonsmoke_specimens_binary_raw_obj_amd64) $(nonsmoke_specimens_binary_raw_archive_amd64) $(nonsmoke_specimens_binary_raw_so_amd64) $(nonsmoke_specimens_binary_raw_core_amd64) $(nonsmoke_specimens_binary_raw_insns_amd64) $(nonsmoke_specimens_binary_raw_rot13_amd64)
nonsmoke_specimens_binary_raw_any_arm = $(nonsmoke_specimens_binary_raw_exe_arm) $(nonsmoke_specimens_binary_raw_obj_arm) $(nonsmoke_specimens_binary_raw_archive_arm) $(nonsmoke_specimens_binary_raw_so_arm) $(nonsmoke_specimens_binary_raw_core_arm) $(nonsmoke_specimens_binary_raw_insns_arm) $(nonsmoke_specimens_binary_raw_rot13_arm)
nonsmoke_specimens_binary_raw_any_mips = $(nonsmoke_specimens_binary_raw_exe_mips) $(nonsmoke_specimens_binary_raw_obj_mips) $(nonsmoke_specimens_binary_raw_archive_mips) $(nonsmoke_specimens_binary_raw_so_mips) $(nonsmoke_specimens_binary_raw_core_mips) $(nonsmoke_specimens_binary_raw_insns_mips) $(nonsmoke_specimens_binary_raw_rot13_mips)
nonsmoke_specimens_binary_raw_any_m68k = $(nonsmoke_specimens_binary_raw_exe_m68k) $(nonsmoke_specimens_binary_raw_obj_m68k) $(nonsmoke_specimens_binary_raw_archive_m68k) $(nonsmoke_specimens_binary_raw_so_m68k) $(nonsmoke_specimens_binary_raw_core_m68k) $(nonsmoke_specimens_binary_raw_insns_m68k) $(nonsmoke_specimens_binary_raw_rot13_m68k)
nonsmoke_specimens_binary_raw_any_ppc = $(nonsmoke_specimens_binary_raw_exe_ppc) $(nonsmoke_specimens_binary_raw_obj_ppc) $(nonsmoke_specimens_binary_raw_archive_ppc) $(nonsmoke_specimens_binary_raw_so_ppc) $(nonsmoke_specimens_binary_raw_core_ppc) $(nonsmoke_specimens_binary_raw_insns_ppc) $(nonsmoke_specimens_binary_raw_rot13_ppc)
nonsmoke_specimens_binary_raw_any_x86 = $(nonsmoke_specimens_binary_raw_exe_x86) $(nonsmoke_specimens_binary_raw_obj_x86) $(nonsmoke_specimens_binary_raw_archive_x86) $(nonsmoke_specimens_binary_raw_so_x86) $(nonsmoke_specimens_binary_raw_core_x86) $(nonsmoke_specimens_binary_raw_insns_x86) $(nonsmoke_specimens_binary_raw_rot13_x86)

# Architecture agnostic
nonsmoke_specimens_binary_dos_exe_any = $(nonsmoke_specimens_binary_dos_exe_amd64) $(nonsmoke_specimens_binary_dos_exe_arm) $(nonsmoke_specimens_binary_dos_exe_mips) $(nonsmoke_specimens_binary_dos_exe_m68k) $(nonsmoke_specimens_binary_dos_exe_ppc) $(nonsmoke_specimens_binary_dos_exe_x86)
nonsmoke_specimens_binary_dos_obj_any = $(nonsmoke_specimens_binary_dos_obj_amd64) $(nonsmoke_specimens_binary_dos_obj_arm) $(nonsmoke_specimens_binary_dos_obj_mips) $(nonsmoke_specimens_binary_dos_obj_m68k) $(nonsmoke_specimens_binary_dos_obj_ppc) $(nonsmoke_specimens_binary_dos_obj_x86)
nonsmoke_specimens_binary_dos_archive_any = $(nonsmoke_specimens_binary_dos_archive_amd64) $(nonsmoke_specimens_binary_dos_archive_arm) $(nonsmoke_specimens_binary_dos_archive_mips) $(nonsmoke_specimens_binary_dos_archive_m68k) $(nonsmoke_specimens_binary_dos_archive_ppc) $(nonsmoke_specimens_binary_dos_archive_x86)
nonsmoke_specimens_binary_dos_so_any = $(nonsmoke_specimens_binary_dos_so_amd64) $(nonsmoke_specimens_binary_dos_so_arm) $(nonsmoke_specimens_binary_dos_so_mips) $(nonsmoke_specimens_binary_dos_so_m68k) $(nonsmoke_specimens_binary_dos_so_ppc) $(nonsmoke_specimens_binary_dos_so_x86)
nonsmoke_specimens_binary_dos_core_any = $(nonsmoke_specimens_binary_dos_core_amd64) $(nonsmoke_specimens_binary_dos_core_arm) $(nonsmoke_specimens_binary_dos_core_mips) $(nonsmoke_specimens_binary_dos_core_m68k) $(nonsmoke_specimens_binary_dos_core_ppc) $(nonsmoke_specimens_binary_dos_core_x86)
nonsmoke_specimens_binary_dos_insns_any = $(nonsmoke_specimens_binary_dos_insns_amd64) $(nonsmoke_specimens_binary_dos_insns_arm) $(nonsmoke_specimens_binary_dos_insns_mips) $(nonsmoke_specimens_binary_dos_insns_m68k) $(nonsmoke_specimens_binary_dos_insns_ppc) $(nonsmoke_specimens_binary_dos_insns_x86)
nonsmoke_specimens_binary_dos_rot13_any = $(nonsmoke_specimens_binary_dos_rot13_amd64) $(nonsmoke_specimens_binary_dos_rot13_arm) $(nonsmoke_specimens_binary_dos_rot13_mips) $(nonsmoke_specimens_binary_dos_rot13_m68k) $(nonsmoke_specimens_binary_dos_rot13_ppc) $(nonsmoke_specimens_binary_dos_rot13_x86)
nonsmoke_specimens_binary_elf_exe_any = $(nonsmoke_specimens_binary_elf_exe_amd64) $(nonsmoke_specimens_binary_elf_exe_arm) $(nonsmoke_specimens_binary_elf_exe_mips) $(nonsmoke_specimens_binary_elf_exe_m68k) $(nonsmoke_specimens_binary_elf_exe_ppc) $(nonsmoke_specimens_binary_elf_exe_x86)
nonsmoke_specimens_binary_elf_obj_any = $(nonsmoke_specimens_binary_elf_obj_amd64) $(nonsmoke_specimens_binary_elf_obj_arm) $(nonsmoke_specimens_binary_elf_obj_mips) $(nonsmoke_specimens_binary_elf_obj_m68k) $(nonsmoke_specimens_binary_elf_obj_ppc) $(nonsmoke_specimens_binary_elf_obj_x86)
nonsmoke_specimens_binary_elf_archive_any = $(nonsmoke_specimens_binary_elf_archive_amd64) $(nonsmoke_specimens_binary_elf_archive_arm) $(nonsmoke_specimens_binary_elf_archive_mips) $(nonsmoke_specimens_binary_elf_archive_m68k) $(nonsmoke_specimens_binary_elf_archive_ppc) $(nonsmoke_specimens_binary_elf_archive_x86)
nonsmoke_specimens_binary_elf_so_any = $(nonsmoke_specimens_binary_elf_so_amd64) $(nonsmoke_specimens_binary_elf_so_arm) $(nonsmoke_specimens_binary_elf_so_mips) $(nonsmoke_specimens_binary_elf_so_m68k) $(nonsmoke_specimens_binary_elf_so_ppc) $(nonsmoke_specimens_binary_elf_so_x86)
nonsmoke_specimens_binary_elf_core_any = $(nonsmoke_specimens_binary_elf_core_amd64) $(nonsmoke_specimens_binary_elf_core_arm) $(nonsmoke_specimens_binary_elf_core_mips) $(nonsmoke_specimens_binary_elf_core_m68k) $(nonsmoke_specimens_binary_elf_core_ppc) $(nonsmoke_specimens_binary_elf_core_x86)
nonsmoke_specimens_binary_elf_insns_any = $(nonsmoke_specimens_binary_elf_insns_amd64) $(nonsmoke_specimens_binary_elf_insns_arm) $(nonsmoke_specimens_binary_elf_insns_mips) $(nonsmoke_specimens_binary_elf_insns_m68k) $(nonsmoke_specimens_binary_elf_insns_ppc) $(nonsmoke_specimens_binary_elf_insns_x86)
nonsmoke_specimens_binary_elf_rot13_any = $(nonsmoke_specimens_binary_elf_rot13_amd64) $(nonsmoke_specimens_binary_elf_rot13_arm) $(nonsmoke_specimens_binary_elf_rot13_mips) $(nonsmoke_specimens_binary_elf_rot13_m68k) $(nonsmoke_specimens_binary_elf_rot13_ppc) $(nonsmoke_specimens_binary_elf_rot13_x86)
nonsmoke_specimens_binary_pe_exe_any = $(nonsmoke_specimens_binary_pe_exe_amd64) $(nonsmoke_specimens_binary_pe_exe_arm) $(nonsmoke_specimens_binary_pe_exe_mips) $(nonsmoke_specimens_binary_pe_exe_m68k) $(nonsmoke_specimens_binary_pe_exe_ppc) $(nonsmoke_specimens_binary_pe_exe_x86)
nonsmoke_specimens_binary_pe_obj_any = $(nonsmoke_specimens_binary_pe_obj_amd64) $(nonsmoke_specimens_binary_pe_obj_arm) $(nonsmoke_specimens_binary_pe_obj_mips) $(nonsmoke_specimens_binary_pe_obj_m68k) $(nonsmoke_specimens_binary_pe_obj_ppc) $(nonsmoke_specimens_binary_pe_obj_x86)
nonsmoke_specimens_binary_pe_archive_any = $(nonsmoke_specimens_binary_pe_archive_amd64) $(nonsmoke_specimens_binary_pe_archive_arm) $(nonsmoke_specimens_binary_pe_archive_mips) $(nonsmoke_specimens_binary_pe_archive_m68k) $(nonsmoke_specimens_binary_pe_archive_ppc) $(nonsmoke_specimens_binary_pe_archive_x86)
nonsmoke_specimens_binary_pe_so_any = $(nonsmoke_specimens_binary_pe_so_amd64) $(nonsmoke_specimens_binary_pe_so_arm) $(nonsmoke_specimens_binary_pe_so_mips) $(nonsmoke_specimens_binary_pe_so_m68k) $(nonsmoke_specimens_binary_pe_so_ppc) $(nonsmoke_specimens_binary_pe_so_x86)
nonsmoke_specimens_binary_pe_core_any = $(nonsmoke_specimens_binary_pe_core_amd64) $(nonsmoke_specimens_binary_pe_core_arm) $(nonsmoke_specimens_binary_pe_core_mips) $(nonsmoke_specimens_binary_pe_core_m68k) $(nonsmoke_specimens_binary_pe_core_ppc) $(nonsmoke_specimens_binary_pe_core_x86)
nonsmoke_specimens_binary_pe_insns_any = $(nonsmoke_specimens_binary_pe_insns_amd64) $(nonsmoke_specimens_binary_pe_insns_arm) $(nonsmoke_specimens_binary_pe_insns_mips) $(nonsmoke_specimens_binary_pe_insns_m68k) $(nonsmoke_specimens_binary_pe_insns_ppc) $(nonsmoke_specimens_binary_pe_insns_x86)
nonsmoke_specimens_binary_pe_rot13_any = $(nonsmoke_specimens_binary_pe_rot13_amd64) $(nonsmoke_specimens_binary_pe_rot13_arm) $(nonsmoke_specimens_binary_pe_rot13_mips) $(nonsmoke_specimens_binary_pe_rot13_m68k) $(nonsmoke_specimens_binary_pe_rot13_ppc) $(nonsmoke_specimens_binary_pe_rot13_x86)
nonsmoke_specimens_binary_raw_exe_any = $(nonsmoke_specimens_binary_raw_exe_amd64) $(nonsmoke_specimens_binary_raw_exe_arm) $(nonsmoke_specimens_binary_raw_exe_mips) $(nonsmoke_specimens_binary_raw_exe_m68k) $(nonsmoke_specimens_binary_raw_exe_ppc) $(nonsmoke_specimens_binary_raw_exe_x86)
nonsmoke_specimens_binary_raw_obj_any = $(nonsmoke_specimens_binary_raw_obj_amd64) $(nonsmoke_specimens_binary_raw_obj_arm) $(nonsmoke_specimens_binary_raw_obj_mips) $(nonsmoke_specimens_binary_raw_obj_m68k) $(nonsmoke_specimens_binary_raw_obj_ppc) $(nonsmoke_specimens_binary_raw_obj_x86)
nonsmoke_specimens_binary_raw_archive_any = $(nonsmoke_specimens_binary_raw_archive_amd64) $(nonsmoke_specimens_binary_raw_archive_arm) $(nonsmoke_specimens_binary_raw_archive_mips) $(nonsmoke_specimens_binary_raw_archive_m68k) $(nonsmoke_specimens_binary_raw_archive_ppc) $(nonsmoke_specimens_binary_raw_archive_x86)
nonsmoke_specimens_binary_raw_so_any = $(nonsmoke_specimens_binary_raw_so_amd64) $(nonsmoke_specimens_binary_raw_so_arm) $(nonsmoke_specimens_binary_raw_so_mips) $(nonsmoke_specimens_binary_raw_so_m68k) $(nonsmoke_specimens_binary_raw_so_ppc) $(nonsmoke_specimens_binary_raw_so_x86)
nonsmoke_specimens_binary_raw_core_any = $(nonsmoke_specimens_binary_raw_core_amd64) $(nonsmoke_specimens_binary_raw_core_arm) $(nonsmoke_specimens_binary_raw_core_mips) $(nonsmoke_specimens_binary_raw_core_m68k) $(nonsmoke_specimens_binary_raw_core_ppc) $(nonsmoke_specimens_binary_raw_core_x86)
nonsmoke_specimens_binary_raw_insns_any = $(nonsmoke_specimens_binary_raw_insns_amd64) $(nonsmoke_specimens_binary_raw_insns_arm) $(nonsmoke_specimens_binary_raw_insns_mips) $(nonsmoke_specimens_binary_raw_insns_m68k) $(nonsmoke_specimens_binary_raw_insns_ppc) $(nonsmoke_specimens_binary_raw_insns_x86)
nonsmoke_specimens_binary_raw_rot13_any = $(nonsmoke_specimens_binary_raw_rot13_amd64) $(nonsmoke_specimens_binary_raw_rot13_arm) $(nonsmoke_specimens_binary_raw_rot13_mips) $(nonsmoke_specimens_binary_raw_rot13_m68k) $(nonsmoke_specimens_binary_raw_rot13_ppc) $(nonsmoke_specimens_binary_raw_rot13_x86)

# Filetype and architecture agnostic
nonsmoke_specimens_binary_dos_any_any = $(nonsmoke_specimens_binary_dos_exe_amd64) $(nonsmoke_specimens_binary_dos_exe_arm) $(nonsmoke_specimens_binary_dos_exe_mips) $(nonsmoke_specimens_binary_dos_exe_m68k) $(nonsmoke_specimens_binary_dos_exe_ppc) $(nonsmoke_specimens_binary_dos_exe_x86) $(nonsmoke_specimens_binary_dos_obj_amd64) $(nonsmoke_specimens_binary_dos_obj_arm) $(nonsmoke_specimens_binary_dos_obj_mips) $(nonsmoke_specimens_binary_dos_obj_m68k) $(nonsmoke_specimens_binary_dos_obj_ppc) $(nonsmoke_specimens_binary_dos_obj_x86) $(nonsmoke_specimens_binary_dos_archive_amd64) $(nonsmoke_specimens_binary_dos_archive_arm) $(nonsmoke_specimens_binary_dos_archive_mips) $(nonsmoke_specimens_binary_dos_archive_m68k) $(nonsmoke_specimens_binary_dos_archive_ppc) $(nonsmoke_specimens_binary_dos_archive_x86) $(nonsmoke_specimens_binary_dos_so_amd64) $(nonsmoke_specimens_binary_dos_so_arm) $(nonsmoke_specimens_binary_dos_so_mips) $(nonsmoke_specimens_binary_dos_so_m68k) $(nonsmoke_specimens_binary_dos_so_ppc) $(nonsmoke_specimens_binary_dos_so_x86) $(nonsmoke_specimens_binary_dos_core_amd64) $(nonsmoke_specimens_binary_dos_core_arm) $(nonsmoke_specimens_binary_dos_core_mips) $(nonsmoke_specimens_binary_dos_core_m68k) $(nonsmoke_specimens_binary_dos_core_ppc) $(nonsmoke_specimens_binary_dos_core_x86) $(nonsmoke_specimens_binary_dos_insns_amd64) $(nonsmoke_specimens_binary_dos_insns_arm) $(nonsmoke_specimens_binary_dos_insns_mips) $(nonsmoke_specimens_binary_dos_insns_m68k) $(nonsmoke_specimens_binary_dos_insns_ppc) $(nonsmoke_specimens_binary_dos_insns_x86) $(nonsmoke_specimens_binary_dos_rot13_amd64) $(nonsmoke_specimens_binary_dos_rot13_arm) $(nonsmoke_specimens_binary_dos_rot13_mips) $(nonsmoke_specimens_binary_dos_rot13_m68k) $(nonsmoke_specimens_binary_dos_rot13_ppc) $(nonsmoke_specimens_binary_dos_rot13_x86)
nonsmoke_specimens_binary_elf_any_any = $(nonsmoke_specimens_binary_elf_exe_amd64) $(nonsmoke_specimens_binary_elf_exe_arm) $(nonsmoke_specimens_binary_elf_exe_mips) $(nonsmoke_specimens_binary_elf_exe_m68k) $(nonsmoke_specimens_binary_elf_exe_ppc) $(nonsmoke_specimens_binary_elf_exe_x86) $(nonsmoke_specimens_binary_elf_obj_amd64) $(nonsmoke_specimens_binary_elf_obj_arm) $(nonsmoke_specimens_binary_elf_obj_mips) $(nonsmoke_specimens_binary_elf_obj_m68k) $(nonsmoke_specimens_binary_elf_obj_ppc) $(nonsmoke_specimens_binary_elf_obj_x86) $(nonsmoke_specimens_binary_elf_archive_amd64) $(nonsmoke_specimens_binary_elf_archive_arm) $(nonsmoke_specimens_binary_elf_archive_mips) $(nonsmoke_specimens_binary_elf_archive_m68k) $(nonsmoke_specimens_binary_elf_archive_ppc) $(nonsmoke_specimens_binary_elf_archive_x86) $(nonsmoke_specimens_binary_elf_so_amd64) $(nonsmoke_specimens_binary_elf_so_arm) $(nonsmoke_specimens_binary_elf_so_mips) $(nonsmoke_specimens_binary_elf_so_m68k) $(nonsmoke_specimens_binary_elf_so_ppc) $(nonsmoke_specimens_binary_elf_so_x86) $(nonsmoke_specimens_binary_elf_core_amd64) $(nonsmoke_specimens_binary_elf_core_arm) $(nonsmoke_specimens_binary_elf_core_mips) $(nonsmoke_specimens_binary_elf_core_m68k) $(nonsmoke_specimens_binary_elf_core_ppc) $(nonsmoke_specimens_binary_elf_core_x86) $(nonsmoke_specimens_binary_elf_insns_amd64) $(nonsmoke_specimens_binary_elf_insns_arm) $(nonsmoke_specimens_binary_elf_insns_mips) $(nonsmoke_specimens_binary_elf_insns_m68k) $(nonsmoke_specimens_binary_elf_insns_ppc) $(nonsmoke_specimens_binary_elf_insns_x86) $(nonsmoke_specimens_binary_elf_rot13_amd64) $(nonsmoke_specimens_binary_elf_rot13_arm) $(nonsmoke_specimens_binary_elf_rot13_mips) $(nonsmoke_specimens_binary_elf_rot13_m68k) $(nonsmoke_specimens_binary_elf_rot13_ppc) $(nonsmoke_specimens_binary_elf_rot13_x86)
nonsmoke_specimens_binary_pe_any_any = $(nonsmoke_specimens_binary_pe_exe_amd64) $(nonsmoke_specimens_binary_pe_exe_arm) $(nonsmoke_specimens_binary_pe_exe_mips) $(nonsmoke_specimens_binary_pe_exe_m68k) $(nonsmoke_specimens_binary_pe_exe_ppc) $(nonsmoke_specimens_binary_pe_exe_x86) $(nonsmoke_specimens_binary_pe_obj_amd64) $(nonsmoke_specimens_binary_pe_obj_arm) $(nonsmoke_specimens_binary_pe_obj_mips) $(nonsmoke_specimens_binary_pe_obj_m68k) $(nonsmoke_specimens_binary_pe_obj_ppc) $(nonsmoke_specimens_binary_pe_obj_x86) $(nonsmoke_specimens_binary_pe_archive_amd64) $(nonsmoke_specimens_binary_pe_archive_arm) $(nonsmoke_specimens_binary_pe_archive_mips) $(nonsmoke_specimens_binary_pe_archive_m68k) $(nonsmoke_specimens_binary_pe_archive_ppc) $(nonsmoke_specimens_binary_pe_archive_x86) $(nonsmoke_specimens_binary_pe_so_amd64) $(nonsmoke_specimens_binary_pe_so_arm) $(nonsmoke_specimens_binary_pe_so_mips) $(nonsmoke_specimens_binary_pe_so_m68k) $(nonsmoke_specimens_binary_pe_so_ppc) $(nonsmoke_specimens_binary_pe_so_x86) $(nonsmoke_specimens_binary_pe_core_amd64) $(nonsmoke_specimens_binary_pe_core_arm) $(nonsmoke_specimens_binary_pe_core_mips) $(nonsmoke_specimens_binary_pe_core_m68k) $(nonsmoke_specimens_binary_pe_core_ppc) $(nonsmoke_specimens_binary_pe_core_x86) $(nonsmoke_specimens_binary_pe_insns_amd64) $(nonsmoke_specimens_binary_pe_insns_arm) $(nonsmoke_specimens_binary_pe_insns_mips) $(nonsmoke_specimens_binary_pe_insns_m68k) $(nonsmoke_specimens_binary_pe_insns_ppc) $(nonsmoke_specimens_binary_pe_insns_x86) $(nonsmoke_specimens_binary_pe_rot13_amd64) $(nonsmoke_specimens_binary_pe_rot13_arm) $(nonsmoke_specimens_binary_pe_rot13_mips) $(nonsmoke_specimens_binary_pe_rot13_m68k) $(nonsmoke_specimens_binary_pe_rot13_ppc) $(nonsmoke_specimens_binary_pe_rot13_x86)
nonsmoke_specimens_binary_raw_any_any = $(nonsmoke_specimens_binary_raw_exe_amd64) $(nonsmoke_specimens_binary_raw_exe_arm) $(nonsmoke_specimens_binary_raw_exe_mips) $(nonsmoke_specimens_binary_raw_exe_m68k) $(nonsmoke_specimens_binary_raw_exe_ppc) $(nonsmoke_specimens_binary_raw_exe_x86) $(nonsmoke_specimens_binary_raw_obj_amd64) $(nonsmoke_specimens_binary_raw_obj_arm) $(nonsmoke_specimens_binary_raw_obj_mips) $(nonsmoke_specimens_binary_raw_obj_m68k) $(nonsmoke_specimens_binary_raw_obj_ppc) $(nonsmoke_specimens_binary_raw_obj_x86) $(nonsmoke_specimens_binary_raw_archive_amd64) $(nonsmoke_specimens_binary_raw_archive_arm) $(nonsmoke_specimens_binary_raw_archive_mips) $(nonsmoke_specimens_binary_raw_archive_m68k) $(nonsmoke_specimens_binary_raw_archive_ppc) $(nonsmoke_specimens_binary_raw_archive_x86) $(nonsmoke_specimens_binary_raw_so_amd64) $(nonsmoke_specimens_binary_raw_so_arm) $(nonsmoke_specimens_binary_raw_so_mips) $(nonsmoke_specimens_binary_raw_so_m68k) $(nonsmoke_specimens_binary_raw_so_ppc) $(nonsmoke_specimens_binary_raw_so_x86) $(nonsmoke_specimens_binary_raw_core_amd64) $(nonsmoke_specimens_binary_raw_core_arm) $(nonsmoke_specimens_binary_raw_core_mips) $(nonsmoke_specimens_binary_raw_core_m68k) $(nonsmoke_specimens_binary_raw_core_ppc) $(nonsmoke_specimens_binary_raw_core_x86) $(nonsmoke_specimens_binary_raw_insns_amd64) $(nonsmoke_specimens_binary_raw_insns_arm) $(nonsmoke_specimens_binary_raw_insns_mips) $(nonsmoke_specimens_binary_raw_insns_m68k) $(nonsmoke_specimens_binary_raw_insns_ppc) $(nonsmoke_specimens_binary_raw_insns_x86) $(nonsmoke_specimens_binary_raw_rot13_amd64) $(nonsmoke_specimens_binary_raw_rot13_arm) $(nonsmoke_specimens_binary_raw_rot13_mips) $(nonsmoke_specimens_binary_raw_rot13_m68k) $(nonsmoke_specimens_binary_raw_rot13_ppc) $(nonsmoke_specimens_binary_raw_rot13_x86)

# Container and architecture agnostic
nonsmoke_specimens_binary_any_exe_any = $(nonsmoke_specimens_binary_dos_exe_amd64) $(nonsmoke_specimens_binary_dos_exe_arm) $(nonsmoke_specimens_binary_dos_exe_mips) $(nonsmoke_specimens_binary_dos_exe_m68k) $(nonsmoke_specimens_binary_dos_exe_ppc) $(nonsmoke_specimens_binary_dos_exe_x86) $(nonsmoke_specimens_binary_elf_exe_amd64) $(nonsmoke_specimens_binary_elf_exe_arm) $(nonsmoke_specimens_binary_elf_exe_mips) $(nonsmoke_specimens_binary_elf_exe_m68k) $(nonsmoke_specimens_binary_elf_exe_ppc) $(nonsmoke_specimens_binary_elf_exe_x86) $(nonsmoke_specimens_binary_pe_exe_amd64) $(nonsmoke_specimens_binary_pe_exe_arm) $(nonsmoke_specimens_binary_pe_exe_mips) $(nonsmoke_specimens_binary_pe_exe_m68k) $(nonsmoke_specimens_binary_pe_exe_ppc) $(nonsmoke_specimens_binary_pe_exe_x86) $(nonsmoke_specimens_binary_raw_exe_amd64) $(nonsmoke_specimens_binary_raw_exe_arm) $(nonsmoke_specimens_binary_raw_exe_mips) $(nonsmoke_specimens_binary_raw_exe_m68k) $(nonsmoke_specimens_binary_raw_exe_ppc) $(nonsmoke_specimens_binary_raw_exe_x86)
nonsmoke_specimens_binary_any_obj_any = $(nonsmoke_specimens_binary_dos_obj_amd64) $(nonsmoke_specimens_binary_dos_obj_arm) $(nonsmoke_specimens_binary_dos_obj_mips) $(nonsmoke_specimens_binary_dos_obj_m68k) $(nonsmoke_specimens_binary_dos_obj_ppc) $(nonsmoke_specimens_binary_dos_obj_x86) $(nonsmoke_specimens_binary_elf_obj_amd64) $(nonsmoke_specimens_binary_elf_obj_arm) $(nonsmoke_specimens_binary_elf_obj_mips) $(nonsmoke_specimens_binary_elf_obj_m68k) $(nonsmoke_specimens_binary_elf_obj_ppc) $(nonsmoke_specimens_binary_elf_obj_x86) $(nonsmoke_specimens_binary_pe_obj_amd64) $(nonsmoke_specimens_binary_pe_obj_arm) $(nonsmoke_specimens_binary_pe_obj_mips) $(nonsmoke_specimens_binary_pe_obj_m68k) $(nonsmoke_specimens_binary_pe_obj_ppc) $(nonsmoke_specimens_binary_pe_obj_x86) $(nonsmoke_specimens_binary_raw_obj_amd64) $(nonsmoke_specimens_binary_raw_obj_arm) $(nonsmoke_specimens_binary_raw_obj_mips) $(nonsmoke_specimens_binary_raw_obj_m68k) $(nonsmoke_specimens_binary_raw_obj_ppc) $(nonsmoke_specimens_binary_raw_obj_x86)
nonsmoke_specimens_binary_any_archive_any = $(nonsmoke_specimens_binary_dos_archive_amd64) $(nonsmoke_specimens_binary_dos_archive_arm) $(nonsmoke_specimens_binary_dos_archive_mips) $(nonsmoke_specimens_binary_dos_archive_m68k) $(nonsmoke_specimens_binary_dos_archive_ppc) $(nonsmoke_specimens_binary_dos_archive_x86) $(nonsmoke_specimens_binary_elf_archive_amd64) $(nonsmoke_specimens_binary_elf_archive_arm) $(nonsmoke_specimens_binary_elf_archive_mips) $(nonsmoke_specimens_binary_elf_archive_m68k) $(nonsmoke_specimens_binary_elf_archive_ppc) $(nonsmoke_specimens_binary_elf_archive_x86) $(nonsmoke_specimens_binary_pe_archive_amd64) $(nonsmoke_specimens_binary_pe_archive_arm) $(nonsmoke_specimens_binary_pe_archive_mips) $(nonsmoke_specimens_binary_pe_archive_m68k) $(nonsmoke_specimens_binary_pe_archive_ppc) $(nonsmoke_specimens_binary_pe_archive_x86) $(nonsmoke_specimens_binary_raw_archive_amd64) $(nonsmoke_specimens_binary_raw_archive_arm) $(nonsmoke_specimens_binary_raw_archive_mips) $(nonsmoke_specimens_binary_raw_archive_m68k) $(nonsmoke_specimens_binary_raw_archive_ppc) $(nonsmoke_specimens_binary_raw_archive_x86)
nonsmoke_specimens_binary_any_so_any = $(nonsmoke_specimens_binary_dos_so_amd64) $(nonsmoke_specimens_binary_dos_so_arm) $(nonsmoke_specimens_binary_dos_so_mips) $(nonsmoke_specimens_binary_dos_so_m68k) $(nonsmoke_specimens_binary_dos_so_ppc) $(nonsmoke_specimens_binary_dos_so_x86) $(nonsmoke_specimens_binary_elf_so_amd64) $(nonsmoke_specimens_binary_elf_so_arm) $(nonsmoke_specimens_binary_elf_so_mips) $(nonsmoke_specimens_binary_elf_so_m68k) $(nonsmoke_specimens_binary_elf_so_ppc) $(nonsmoke_specimens_binary_elf_so_x86) $(nonsmoke_specimens_binary_pe_so_amd64) $(nonsmoke_specimens_binary_pe_so_arm) $(nonsmoke_specimens_binary_pe_so_mips) $(nonsmoke_specimens_binary_pe_so_m68k) $(nonsmoke_specimens_binary_pe_so_ppc) $(nonsmoke_specimens_binary_pe_so_x86) $(nonsmoke_specimens_binary_raw_so_amd64) $(nonsmoke_specimens_binary_raw_so_arm) $(nonsmoke_specimens_binary_raw_so_mips) $(nonsmoke_specimens_binary_raw_so_m68k) $(nonsmoke_specimens_binary_raw_so_ppc) $(nonsmoke_specimens_binary_raw_so_x86)
nonsmoke_specimens_binary_any_core_any = $(nonsmoke_specimens_binary_dos_core_amd64) $(nonsmoke_specimens_binary_dos_core_arm) $(nonsmoke_specimens_binary_dos_core_mips) $(nonsmoke_specimens_binary_dos_core_m68k) $(nonsmoke_specimens_binary_dos_core_ppc) $(nonsmoke_specimens_binary_dos_core_x86) $(nonsmoke_specimens_binary_elf_core_amd64) $(nonsmoke_specimens_binary_elf_core_arm) $(nonsmoke_specimens_binary_elf_core_mips) $(nonsmoke_specimens_binary_elf_core_m68k) $(nonsmoke_specimens_binary_elf_core_ppc) $(nonsmoke_specimens_binary_elf_core_x86) $(nonsmoke_specimens_binary_pe_core_amd64) $(nonsmoke_specimens_binary_pe_core_arm) $(nonsmoke_specimens_binary_pe_core_mips) $(nonsmoke_specimens_binary_pe_core_m68k) $(nonsmoke_specimens_binary_pe_core_ppc) $(nonsmoke_specimens_binary_pe_core_x86) $(nonsmoke_specimens_binary_raw_core_amd64) $(nonsmoke_specimens_binary_raw_core_arm) $(nonsmoke_specimens_binary_raw_core_mips) $(nonsmoke_specimens_binary_raw_core_m68k) $(nonsmoke_specimens_binary_raw_core_ppc) $(nonsmoke_specimens_binary_raw_core_x86)
nonsmoke_specimens_binary_any_insns_any = $(nonsmoke_specimens_binary_dos_insns_amd64) $(nonsmoke_specimens_binary_dos_insns_arm) $(nonsmoke_specimens_binary_dos_insns_mips) $(nonsmoke_specimens_binary_dos_insns_m68k) $(nonsmoke_specimens_binary_dos_insns_ppc) $(nonsmoke_specimens_binary_dos_insns_x86) $(nonsmoke_specimens_binary_elf_insns_amd64) $(nonsmoke_specimens_binary_elf_insns_arm) $(nonsmoke_specimens_binary_elf_insns_mips) $(nonsmoke_specimens_binary_elf_insns_m68k) $(nonsmoke_specimens_binary_elf_insns_ppc) $(nonsmoke_specimens_binary_elf_insns_x86) $(nonsmoke_specimens_binary_pe_insns_amd64) $(nonsmoke_specimens_binary_pe_insns_arm) $(nonsmoke_specimens_binary_pe_insns_mips) $(nonsmoke_specimens_binary_pe_insns_m68k) $(nonsmoke_specimens_binary_pe_insns_ppc) $(nonsmoke_specimens_binary_pe_insns_x86) $(nonsmoke_specimens_binary_raw_insns_amd64) $(nonsmoke_specimens_binary_raw_insns_arm) $(nonsmoke_specimens_binary_raw_insns_mips) $(nonsmoke_specimens_binary_raw_insns_m68k) $(nonsmoke_specimens_binary_raw_insns_ppc) $(nonsmoke_specimens_binary_raw_insns_x86)
nonsmoke_specimens_binary_any_rot13_any = $(nonsmoke_specimens_binary_dos_rot13_amd64) $(nonsmoke_specimens_binary_dos_rot13_arm) $(nonsmoke_specimens_binary_dos_rot13_mips) $(nonsmoke_specimens_binary_dos_rot13_m68k) $(nonsmoke_specimens_binary_dos_rot13_ppc) $(nonsmoke_specimens_binary_dos_rot13_x86) $(nonsmoke_specimens_binary_elf_rot13_amd64) $(nonsmoke_specimens_binary_elf_rot13_arm) $(nonsmoke_specimens_binary_elf_rot13_mips) $(nonsmoke_specimens_binary_elf_rot13_m68k) $(nonsmoke_specimens_binary_elf_rot13_ppc) $(nonsmoke_specimens_binary_elf_rot13_x86) $(nonsmoke_specimens_binary_pe_rot13_amd64) $(nonsmoke_specimens_binary_pe_rot13_arm) $(nonsmoke_specimens_binary_pe_rot13_mips) $(nonsmoke_specimens_binary_pe_rot13_m68k) $(nonsmoke_specimens_binary_pe_rot13_ppc) $(nonsmoke_specimens_binary_pe_rot13_x86) $(nonsmoke_specimens_binary_raw_rot13_amd64) $(nonsmoke_specimens_binary_raw_rot13_arm) $(nonsmoke_specimens_binary_raw_rot13_mips) $(nonsmoke_specimens_binary_raw_rot13_m68k) $(nonsmoke_specimens_binary_raw_rot13_ppc) $(nonsmoke_specimens_binary_raw_rot13_x86)

# Container and filetype agnostic
nonsmoke_specimens_binary_any_any_amd64 = $(nonsmoke_specimens_binary_dos_exe_amd64) $(nonsmoke_specimens_binary_dos_obj_amd64) $(nonsmoke_specimens_binary_dos_archive_amd64) $(nonsmoke_specimens_binary_dos_so_amd64) $(nonsmoke_specimens_binary_dos_core_amd64) $(nonsmoke_specimens_binary_dos_insns_amd64) $(nonsmoke_specimens_binary_dos_rot13_amd64) $(nonsmoke_specimens_binary_elf_exe_amd64) $(nonsmoke_specimens_binary_elf_obj_amd64) $(nonsmoke_specimens_binary_elf_archive_amd64) $(nonsmoke_specimens_binary_elf_so_amd64) $(nonsmoke_specimens_binary_elf_core_amd64) $(nonsmoke_specimens_binary_elf_insns_amd64) $(nonsmoke_specimens_binary_elf_rot13_amd64) $(nonsmoke_specimens_binary_pe_exe_amd64) $(nonsmoke_specimens_binary_pe_obj_amd64) $(nonsmoke_specimens_binary_pe_archive_amd64) $(nonsmoke_specimens_binary_pe_so_amd64) $(nonsmoke_specimens_binary_pe_core_amd64) $(nonsmoke_specimens_binary_pe_insns_amd64) $(nonsmoke_specimens_binary_pe_rot13_amd64) $(nonsmoke_specimens_binary_raw_exe_amd64) $(nonsmoke_specimens_binary_raw_obj_amd64) $(nonsmoke_specimens_binary_raw_archive_amd64) $(nonsmoke_specimens_binary_raw_so_amd64) $(nonsmoke_specimens_binary_raw_core_amd64) $(nonsmoke_specimens_binary_raw_insns_amd64) $(nonsmoke_specimens_binary_raw_rot13_amd64)
nonsmoke_specimens_binary_any_any_arm = $(nonsmoke_specimens_binary_dos_exe_arm) $(nonsmoke_specimens_binary_dos_obj_arm) $(nonsmoke_specimens_binary_dos_archive_arm) $(nonsmoke_specimens_binary_dos_so_arm) $(nonsmoke_specimens_binary_dos_core_arm) $(nonsmoke_specimens_binary_dos_insns_arm) $(nonsmoke_specimens_binary_dos_rot13_arm) $(nonsmoke_specimens_binary_elf_exe_arm) $(nonsmoke_specimens_binary_elf_obj_arm) $(nonsmoke_specimens_binary_elf_archive_arm) $(nonsmoke_specimens_binary_elf_so_arm) $(nonsmoke_specimens_binary_elf_core_arm) $(nonsmoke_specimens_binary_elf_insns_arm) $(nonsmoke_specimens_binary_elf_rot13_arm) $(nonsmoke_specimens_binary_pe_exe_arm) $(nonsmoke_specimens_binary_pe_obj_arm) $(nonsmoke_specimens_binary_pe_archive_arm) $(nonsmoke_specimens_binary_pe_so_arm) $(nonsmoke_specimens_binary_pe_core_arm) $(nonsmoke_specimens_binary_pe_insns_arm) $(nonsmoke_specimens_binary_pe_rot13_arm) $(nonsmoke_specimens_binary_raw_exe_arm) $(nonsmoke_specimens_binary_raw_obj_arm) $(nonsmoke_specimens_binary_raw_archive_arm) $(nonsmoke_specimens_binary_raw_so_arm) $(nonsmoke_specimens_binary_raw_core_arm) $(nonsmoke_specimens_binary_raw_insns_arm) $(nonsmoke_specimens_binary_raw_rot13_arm)
nonsmoke_specimens_binary_any_any_mips = $(nonsmoke_specimens_binary_dos_exe_mips) $(nonsmoke_specimens_binary_dos_obj_mips) $(nonsmoke_specimens_binary_dos_archive_mips) $(nonsmoke_specimens_binary_dos_so_mips) $(nonsmoke_specimens_binary_dos_core_mips) $(nonsmoke_specimens_binary_dos_insns_mips) $(nonsmoke_specimens_binary_dos_rot13_mips) $(nonsmoke_specimens_binary_elf_exe_mips) $(nonsmoke_specimens_binary_elf_obj_mips) $(nonsmoke_specimens_binary_elf_archive_mips) $(nonsmoke_specimens_binary_elf_so_mips) $(nonsmoke_specimens_binary_elf_core_mips) $(nonsmoke_specimens_binary_elf_insns_mips) $(nonsmoke_specimens_binary_elf_rot13_mips) $(nonsmoke_specimens_binary_pe_exe_mips) $(nonsmoke_specimens_binary_pe_obj_mips) $(nonsmoke_specimens_binary_pe_archive_mips) $(nonsmoke_specimens_binary_pe_so_mips) $(nonsmoke_specimens_binary_pe_core_mips) $(nonsmoke_specimens_binary_pe_insns_mips) $(nonsmoke_specimens_binary_pe_rot13_mips) $(nonsmoke_specimens_binary_raw_exe_mips) $(nonsmoke_specimens_binary_raw_obj_mips) $(nonsmoke_specimens_binary_raw_archive_mips) $(nonsmoke_specimens_binary_raw_so_mips) $(nonsmoke_specimens_binary_raw_core_mips) $(nonsmoke_specimens_binary_raw_insns_mips) $(nonsmoke_specimens_binary_raw_rot13_mips)
nonsmoke_specimens_binary_any_any_m68k = $(nonsmoke_specimens_binary_dos_exe_m68k) $(nonsmoke_specimens_binary_dos_obj_m68k) $(nonsmoke_specimens_binary_dos_archive_m68k) $(nonsmoke_specimens_binary_dos_so_m68k) $(nonsmoke_specimens_binary_dos_core_m68k) $(nonsmoke_specimens_binary_dos_insns_m68k) $(nonsmoke_specimens_binary_dos_rot13_m68k) $(nonsmoke_specimens_binary_elf_exe_m68k) $(nonsmoke_specimens_binary_elf_obj_m68k) $(nonsmoke_specimens_binary_elf_archive_m68k) $(nonsmoke_specimens_binary_elf_so_m68k) $(nonsmoke_specimens_binary_elf_core_m68k) $(nonsmoke_specimens_binary_elf_insns_m68k) $(nonsmoke_specimens_binary_elf_rot13_m68k) $(nonsmoke_specimens_binary_pe_exe_m68k) $(nonsmoke_specimens_binary_pe_obj_m68k) $(nonsmoke_specimens_binary_pe_archive_m68k) $(nonsmoke_specimens_binary_pe_so_m68k) $(nonsmoke_specimens_binary_pe_core_m68k) $(nonsmoke_specimens_binary_pe_insns_m68k) $(nonsmoke_specimens_binary_pe_rot13_m68k) $(nonsmoke_specimens_binary_raw_exe_m68k) $(nonsmoke_specimens_binary_raw_obj_m68k) $(nonsmoke_specimens_binary_raw_archive_m68k) $(nonsmoke_specimens_binary_raw_so_m68k) $(nonsmoke_specimens_binary_raw_core_m68k) $(nonsmoke_specimens_binary_raw_insns_m68k) $(nonsmoke_specimens_binary_raw_rot13_m68k)
nonsmoke_specimens_binary_any_any_ppc = $(nonsmoke_specimens_binary_dos_exe_ppc) $(nonsmoke_specimens_binary_dos_obj_ppc) $(nonsmoke_specimens_binary_dos_archive_ppc) $(nonsmoke_specimens_binary_dos_so_ppc) $(nonsmoke_specimens_binary_dos_core_ppc) $(nonsmoke_specimens_binary_dos_insns_ppc) $(nonsmoke_specimens_binary_dos_rot13_ppc) $(nonsmoke_specimens_binary_elf_exe_ppc) $(nonsmoke_specimens_binary_elf_obj_ppc) $(nonsmoke_specimens_binary_elf_archive_ppc) $(nonsmoke_specimens_binary_elf_so_ppc) $(nonsmoke_specimens_binary_elf_core_ppc) $(nonsmoke_specimens_binary_elf_insns_ppc) $(nonsmoke_specimens_binary_elf_rot13_ppc) $(nonsmoke_specimens_binary_pe_exe_ppc) $(nonsmoke_specimens_binary_pe_obj_ppc) $(nonsmoke_specimens_binary_pe_archive_ppc) $(nonsmoke_specimens_binary_pe_so_ppc) $(nonsmoke_specimens_binary_pe_core_ppc) $(nonsmoke_specimens_binary_pe_insns_ppc) $(nonsmoke_specimens_binary_pe_rot13_ppc) $(nonsmoke_specimens_binary_raw_exe_ppc) $(nonsmoke_specimens_binary_raw_obj_ppc) $(nonsmoke_specimens_binary_raw_archive_ppc) $(nonsmoke_specimens_binary_raw_so_ppc) $(nonsmoke_specimens_binary_raw_core_ppc) $(nonsmoke_specimens_binary_raw_insns_ppc) $(nonsmoke_specimens_binary_raw_rot13_ppc)
nonsmoke_specimens_binary_any_any_x86 = $(nonsmoke_specimens_binary_dos_exe_x86) $(nonsmoke_specimens_binary_dos_obj_x86) $(nonsmoke_specimens_binary_dos_archive_x86) $(nonsmoke_specimens_binary_dos_so_x86) $(nonsmoke_specimens_binary_dos_core_x86) $(nonsmoke_specimens_binary_dos_insns_x86) $(nonsmoke_specimens_binary_dos_rot13_x86) $(nonsmoke_specimens_binary_elf_exe_x86) $(nonsmoke_specimens_binary_elf_obj_x86) $(nonsmoke_specimens_binary_elf_archive_x86) $(nonsmoke_specimens_binary_elf_so_x86) $(nonsmoke_specimens_binary_elf_core_x86) $(nonsmoke_specimens_binary_elf_insns_x86) $(nonsmoke_specimens_binary_elf_rot13_x86) $(nonsmoke_specimens_binary_pe_exe_x86) $(nonsmoke_specimens_binary_pe_obj_x86) $(nonsmoke_specimens_binary_pe_archive_x86) $(nonsmoke_specimens_binary_pe_so_x86) $(nonsmoke_specimens_binary_pe_core_x86) $(nonsmoke_specimens_binary_pe_insns_x86) $(nonsmoke_specimens_binary_pe_rot13_x86) $(nonsmoke_specimens_binary_raw_exe_x86) $(nonsmoke_specimens_binary_raw_obj_x86) $(nonsmoke_specimens_binary_raw_archive_x86) $(nonsmoke_specimens_binary_raw_so_x86) $(nonsmoke_specimens_binary_raw_core_x86) $(nonsmoke_specimens_binary_raw_insns_x86) $(nonsmoke_specimens_binary_raw_rot13_x86)

# All binary specimens
nonsmoke_specimens_binary_any_any_any = $(nonsmoke_specimens_binary_dos_exe_amd64) $(nonsmoke_specimens_binary_dos_exe_arm) $(nonsmoke_specimens_binary_dos_exe_mips) $(nonsmoke_specimens_binary_dos_exe_m68k) $(nonsmoke_specimens_binary_dos_exe_ppc) $(nonsmoke_specimens_binary_dos_exe_x86) $(nonsmoke_specimens_binary_dos_obj_amd64) $(nonsmoke_specimens_binary_dos_obj_arm) $(nonsmoke_specimens_binary_dos_obj_mips) $(nonsmoke_specimens_binary_dos_obj_m68k) $(nonsmoke_specimens_binary_dos_obj_ppc) $(nonsmoke_specimens_binary_dos_obj_x86) $(nonsmoke_specimens_binary_dos_archive_amd64) $(nonsmoke_specimens_binary_dos_archive_arm) $(nonsmoke_specimens_binary_dos_archive_mips) $(nonsmoke_specimens_binary_dos_archive_m68k) $(nonsmoke_specimens_binary_dos_archive_ppc) $(nonsmoke_specimens_binary_dos_archive_x86) $(nonsmoke_specimens_binary_dos_so_amd64) $(nonsmoke_specimens_binary_dos_so_arm) $(nonsmoke_specimens_binary_dos_so_mips) $(nonsmoke_specimens_binary_dos_so_m68k) $(nonsmoke_specimens_binary_dos_so_ppc) $(nonsmoke_specimens_binary_dos_so_x86) $(nonsmoke_specimens_binary_dos_core_amd64) $(nonsmoke_specimens_binary_dos_core_arm) $(nonsmoke_specimens_binary_dos_core_mips) $(nonsmoke_specimens_binary_dos_core_m68k) $(nonsmoke_specimens_binary_dos_core_ppc) $(nonsmoke_specimens_binary_dos_core_x86) $(nonsmoke_specimens_binary_dos_insns_amd64) $(nonsmoke_specimens_binary_dos_insns_arm) $(nonsmoke_specimens_binary_dos_insns_mips) $(nonsmoke_specimens_binary_dos_insns_m68k) $(nonsmoke_specimens_binary_dos_insns_ppc) $(nonsmoke_specimens_binary_dos_insns_x86) $(nonsmoke_specimens_binary_dos_rot13_amd64) $(nonsmoke_specimens_binary_dos_rot13_arm) $(nonsmoke_specimens_binary_dos_rot13_mips) $(nonsmoke_specimens_binary_dos_rot13_m68k) $(nonsmoke_specimens_binary_dos_rot13_ppc) $(nonsmoke_specimens_binary_dos_rot13_x86) $(nonsmoke_specimens_binary_elf_exe_amd64) $(nonsmoke_specimens_binary_elf_exe_arm) $(nonsmoke_specimens_binary_elf_exe_mips) $(nonsmoke_specimens_binary_elf_exe_m68k) $(nonsmoke_specimens_binary_elf_exe_ppc) $(nonsmoke_specimens_binary_elf_exe_x86) $(nonsmoke_specimens_binary_elf_obj_amd64) $(nonsmoke_specimens_binary_elf_obj_arm) $(nonsmoke_specimens_binary_elf_obj_mips) $(nonsmoke_specimens_binary_elf_obj_m68k) $(nonsmoke_specimens_binary_elf_obj_ppc) $(nonsmoke_specimens_binary_elf_obj_x86) $(nonsmoke_specimens_binary_elf_archive_amd64) $(nonsmoke_specimens_binary_elf_archive_arm) $(nonsmoke_specimens_binary_elf_archive_mips) $(nonsmoke_specimens_binary_elf_archive_m68k) $(nonsmoke_specimens_binary_elf_archive_ppc) $(nonsmoke_specimens_binary_elf_archive_x86) $(nonsmoke_specimens_binary_elf_so_amd64) $(nonsmoke_specimens_binary_elf_so_arm) $(nonsmoke_specimens_binary_elf_so_mips) $(nonsmoke_specimens_binary_elf_so_m68k) $(nonsmoke_specimens_binary_elf_so_ppc) $(nonsmoke_specimens_binary_elf_so_x86) $(nonsmoke_specimens_binary_elf_core_amd64) $(nonsmoke_specimens_binary_elf_core_arm) $(nonsmoke_specimens_binary_elf_core_mips) $(nonsmoke_specimens_binary_elf_core_m68k) $(nonsmoke_specimens_binary_elf_core_ppc) $(nonsmoke_specimens_binary_elf_core_x86) $(nonsmoke_specimens_binary_elf_insns_amd64) $(nonsmoke_specimens_binary_elf_insns_arm) $(nonsmoke_specimens_binary_elf_insns_mips) $(nonsmoke_specimens_binary_elf_insns_m68k) $(nonsmoke_specimens_binary_elf_insns_ppc) $(nonsmoke_specimens_binary_elf_insns_x86) $(nonsmoke_specimens_binary_elf_rot13_amd64) $(nonsmoke_specimens_binary_elf_rot13_arm) $(nonsmoke_specimens_binary_elf_rot13_mips) $(nonsmoke_specimens_binary_elf_rot13_m68k) $(nonsmoke_specimens_binary_elf_rot13_ppc) $(nonsmoke_specimens_binary_elf_rot13_x86) $(nonsmoke_specimens_binary_pe_exe_amd64) $(nonsmoke_specimens_binary_pe_exe_arm) $(nonsmoke_specimens_binary_pe_exe_mips) $(nonsmoke_specimens_binary_pe_exe_m68k) $(nonsmoke_specimens_binary_pe_exe_ppc) $(nonsmoke_specimens_binary_pe_exe_x86) $(nonsmoke_specimens_binary_pe_obj_amd64) $(nonsmoke_specimens_binary_pe_obj_arm) $(nonsmoke_specimens_binary_pe_obj_mips) $(nonsmoke_specimens_binary_pe_obj_m68k) $(nonsmoke_specimens_binary_pe_obj_ppc) $(nonsmoke_specimens_binary_pe_obj_x86) $(nonsmoke_specimens_binary_pe_archive_amd64) $(nonsmoke_specimens_binary_pe_archive_arm) $(nonsmoke_specimens_binary_pe_archive_mips) $(nonsmoke_specimens_binary_pe_archive_m68k) $(nonsmoke_specimens_binary_pe_archive_ppc) $(nonsmoke_specimens_binary_pe_archive_x86) $(nonsmoke_specimens_binary_pe_so_amd64) $(nonsmoke_specimens_binary_pe_so_arm) $(nonsmoke_specimens_binary_pe_so_mips) $(nonsmoke_specimens_binary_pe_so_m68k) $(nonsmoke_specimens_binary_pe_so_ppc) $(nonsmoke_specimens_binary_pe_so_x86) $(nonsmoke_specimens_binary_pe_core_amd64) $(nonsmoke_specimens_binary_pe_core_arm) $(nonsmoke_specimens_binary_pe_core_mips) $(nonsmoke_specimens_binary_pe_core_m68k) $(nonsmoke_specimens_binary_pe_core_ppc) $(nonsmoke_specimens_binary_pe_core_x86) $(nonsmoke_specimens_binary_pe_insns_amd64) $(nonsmoke_specimens_binary_pe_insns_arm) $(nonsmoke_specimens_binary_pe_insns_mips) $(nonsmoke_specimens_binary_pe_insns_m68k) $(nonsmoke_specimens_binary_pe_insns_ppc) $(nonsmoke_specimens_binary_pe_insns_x86) $(nonsmoke_specimens_binary_pe_rot13_amd64) $(nonsmoke_specimens_binary_pe_rot13_arm) $(nonsmoke_specimens_binary_pe_rot13_mips) $(nonsmoke_specimens_binary_pe_rot13_m68k) $(nonsmoke_specimens_binary_pe_rot13_ppc) $(nonsmoke_specimens_binary_pe_rot13_x86) $(nonsmoke_specimens_binary_raw_exe_amd64) $(nonsmoke_specimens_binary_raw_exe_arm) $(nonsmoke_specimens_binary_raw_exe_mips) $(nonsmoke_specimens_binary_raw_exe_m68k) $(nonsmoke_specimens_binary_raw_exe_ppc) $(nonsmoke_specimens_binary_raw_exe_x86) $(nonsmoke_specimens_binary_raw_obj_amd64) $(nonsmoke_specimens_binary_raw_obj_arm) $(nonsmoke_specimens_binary_raw_obj_mips) $(nonsmoke_specimens_binary_raw_obj_m68k) $(nonsmoke_specimens_binary_raw_obj_ppc) $(nonsmoke_specimens_binary_raw_obj_x86) $(nonsmoke_specimens_binary_raw_archive_amd64) $(nonsmoke_specimens_binary_raw_archive_arm) $(nonsmoke_specimens_binary_raw_archive_mips) $(nonsmoke_specimens_binary_raw_archive_m68k) $(nonsmoke_specimens_binary_raw_archive_ppc) $(nonsmoke_specimens_binary_raw_archive_x86) $(nonsmoke_specimens_binary_raw_so_amd64) $(nonsmoke_specimens_binary_raw_so_arm) $(nonsmoke_specimens_binary_raw_so_mips) $(nonsmoke_specimens_binary_raw_so_m68k) $(nonsmoke_specimens_binary_raw_so_ppc) $(nonsmoke_specimens_binary_raw_so_x86) $(nonsmoke_specimens_binary_raw_core_amd64) $(nonsmoke_specimens_binary_raw_core_arm) $(nonsmoke_specimens_binary_raw_core_mips) $(nonsmoke_specimens_binary_raw_core_m68k) $(nonsmoke_specimens_binary_raw_core_ppc) $(nonsmoke_specimens_binary_raw_core_x86) $(nonsmoke_specimens_binary_raw_insns_amd64) $(nonsmoke_specimens_binary_raw_insns_arm) $(nonsmoke_specimens_binary_raw_insns_mips) $(nonsmoke_specimens_binary_raw_insns_m68k) $(nonsmoke_specimens_binary_raw_insns_ppc) $(nonsmoke_specimens_binary_raw_insns_x86) $(nonsmoke_specimens_binary_raw_rot13_amd64) $(nonsmoke_specimens_binary_raw_rot13_arm) $(nonsmoke_specimens_binary_raw_rot13_mips) $(nonsmoke_specimens_binary_raw_rot13_m68k) $(nonsmoke_specimens_binary_raw_rot13_ppc) $(nonsmoke_specimens_binary_raw_rot13_x86)

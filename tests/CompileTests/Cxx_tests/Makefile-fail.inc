# DQ (8/28/2006): Verified non-working code
TESTCODE_CURRENTLY_FAILING = \
lexPhase2003_02.C \
test2004_25.C \
test2005_69.C \
test2005_85.C \
test2005_115.C \
test2005_151.C \
test2005_188.C \
test2005_200.C \
test2005_201.C \
test2005_204.C \
test2005_205.C \
test2006_09.C \
test2006_11.C \
test2006_15.C \
test2006_21.C \
test2006_24.C \
test2006_27.C \
test2006_33.C \
test2006_35.C \
test2006_36.C \
test2006_49.C \
test2006_60.C \
test2006_64.C \
test2006_127.C \
test2006_128.C \
test2006_130.C \
test2006_131.C \
test2006_138.C \
test2006_167.C \
test2006_168.C \
test2006_169.C \
test2006_170.C \
test2006_171.C \
test2006_172.C \
test2006_173.C \
test2006_174.C \
test2006_175.C \
test2006_176.C \
test2006_180.C \
test2006_182.C \
test2006_184.C \
test2006_186.C \
test2006_187.C \
test2006_188.C \
test2007_18.C \
test2007_19.C \
test2007_20.C \
test2007_22.C \
test2007_27.C \
test2007_30.C \
test2007_31.C \
test2007_32.C \
test2007_33.C \
test2007_34.C \
test2007_35.C \
test2007_36.C \
test2007_37.C \
test2007_39.C \
test2007_42.C \
test2007_45.C \
test2007_51.C \
test2007_52.C \
test2007_54.C \
test2007_56.C \
test2007_58.C \
test2007_60.C \
test2007_61.C \
test2007_63.C \
test2007_64.C \
test2007_65.C \
test2007_66.C \
test2007_67.C \
test2007_68.C \
test2007_69.C \
test2007_71.C \
test2007_73.C \
test2007_74.C \
test2007_76.C \
test2007_79.C \
test2007_80.C \
test2007_86.C \
test2007_87.C \
test2007_88.C \
test2007_89.C \
test2007_91.C \
test2007_92.C \
test2007_93.C \
test2007_96.C \
test2007_97.C \
test2007_99.C \
test2007_100.C \
test2007_101.C \
test2007_104.C \
test2007_105.C \
test2007_106.C \
test2007_107.C \
test2007_108.C \
test2007_109.C \
test2007_110.C \
test2007_111.C \
test2007_112.C \
test2007_113.C \
test2007_114.C \
test2007_115.C \
test2007_116.C \
test2007_117.C \
test2007_118.C \
test2007_119.C \
test2007_120.C \
test2007_121.C \
test2007_122.C \
test2007_123.C \
test2007_124.C \
test2007_125.C \
test2007_126.C \
test2007_127.C \
test2007_129.C \
test2007_131.C \
test2007_132.C \
test2007_134.C \
test2007_136.C \
test2007_138.C \
test2007_139.C \
test2007_143.C \
test2007_144.C \
test2007_145.C \
test2007_146.C \
test2007_148.C \
test2007_149.C \
test2007_153.C \
test2007_156.C \
test2007_168.C \
test2007_174.C \
test2007_175.C \
test2007_176.C \
test2009_07.C \
test2009_13.C \
test2009_17.C \
test2009_21.C \
test2009_22.C \
test2009_29.C \
test2009_32.C \
test2009_33.C \
test2009_34.C \
test2009_35.C \
test2009_36.C \
test2009_38.C \
test2009_43.C \
test2009_44.C \
test2009_45.C \
test2009_46.C \
test2009_47.C \
test2010_01.C \
test2010_02.C \
test2010_07.C \
test2010_08.C \
test2010_09.C \
test2010_10.C \
test2010_11.C \
test2010_12.C \
test2010_15.C \
test2010_16.C \
test2010_17.C \
test2010_22.C \
longFile.C \
certSignalExample.C

# test2010_23.C \
# eof

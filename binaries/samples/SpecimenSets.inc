# Collections of binary specimens                    -*- makefile -*-
# This file is automatically generated by running
#   $ make build-SpecimenSets.inc
# in the $ROSE_BUILD/binaries/samples directory

include $(top_srcdir)/binaries/samples/Specimens.inc

# Container agnostic
any_exe_amd64_specimens = $(dos_exe_amd64_specimens) $(elf_exe_amd64_specimens) $(pe_exe_amd64_specimens) $(raw_exe_amd64_specimens)
any_exe_arm_specimens = $(dos_exe_arm_specimens) $(elf_exe_arm_specimens) $(pe_exe_arm_specimens) $(raw_exe_arm_specimens)
any_exe_mips_specimens = $(dos_exe_mips_specimens) $(elf_exe_mips_specimens) $(pe_exe_mips_specimens) $(raw_exe_mips_specimens)
any_exe_m68k_specimens = $(dos_exe_m68k_specimens) $(elf_exe_m68k_specimens) $(pe_exe_m68k_specimens) $(raw_exe_m68k_specimens)
any_exe_ppc_specimens = $(dos_exe_ppc_specimens) $(elf_exe_ppc_specimens) $(pe_exe_ppc_specimens) $(raw_exe_ppc_specimens)
any_exe_x86_specimens = $(dos_exe_x86_specimens) $(elf_exe_x86_specimens) $(pe_exe_x86_specimens) $(raw_exe_x86_specimens)
any_obj_amd64_specimens = $(dos_obj_amd64_specimens) $(elf_obj_amd64_specimens) $(pe_obj_amd64_specimens) $(raw_obj_amd64_specimens)
any_obj_arm_specimens = $(dos_obj_arm_specimens) $(elf_obj_arm_specimens) $(pe_obj_arm_specimens) $(raw_obj_arm_specimens)
any_obj_mips_specimens = $(dos_obj_mips_specimens) $(elf_obj_mips_specimens) $(pe_obj_mips_specimens) $(raw_obj_mips_specimens)
any_obj_m68k_specimens = $(dos_obj_m68k_specimens) $(elf_obj_m68k_specimens) $(pe_obj_m68k_specimens) $(raw_obj_m68k_specimens)
any_obj_ppc_specimens = $(dos_obj_ppc_specimens) $(elf_obj_ppc_specimens) $(pe_obj_ppc_specimens) $(raw_obj_ppc_specimens)
any_obj_x86_specimens = $(dos_obj_x86_specimens) $(elf_obj_x86_specimens) $(pe_obj_x86_specimens) $(raw_obj_x86_specimens)
any_archive_amd64_specimens = $(dos_archive_amd64_specimens) $(elf_archive_amd64_specimens) $(pe_archive_amd64_specimens) $(raw_archive_amd64_specimens)
any_archive_arm_specimens = $(dos_archive_arm_specimens) $(elf_archive_arm_specimens) $(pe_archive_arm_specimens) $(raw_archive_arm_specimens)
any_archive_mips_specimens = $(dos_archive_mips_specimens) $(elf_archive_mips_specimens) $(pe_archive_mips_specimens) $(raw_archive_mips_specimens)
any_archive_m68k_specimens = $(dos_archive_m68k_specimens) $(elf_archive_m68k_specimens) $(pe_archive_m68k_specimens) $(raw_archive_m68k_specimens)
any_archive_ppc_specimens = $(dos_archive_ppc_specimens) $(elf_archive_ppc_specimens) $(pe_archive_ppc_specimens) $(raw_archive_ppc_specimens)
any_archive_x86_specimens = $(dos_archive_x86_specimens) $(elf_archive_x86_specimens) $(pe_archive_x86_specimens) $(raw_archive_x86_specimens)
any_so_amd64_specimens = $(dos_so_amd64_specimens) $(elf_so_amd64_specimens) $(pe_so_amd64_specimens) $(raw_so_amd64_specimens)
any_so_arm_specimens = $(dos_so_arm_specimens) $(elf_so_arm_specimens) $(pe_so_arm_specimens) $(raw_so_arm_specimens)
any_so_mips_specimens = $(dos_so_mips_specimens) $(elf_so_mips_specimens) $(pe_so_mips_specimens) $(raw_so_mips_specimens)
any_so_m68k_specimens = $(dos_so_m68k_specimens) $(elf_so_m68k_specimens) $(pe_so_m68k_specimens) $(raw_so_m68k_specimens)
any_so_ppc_specimens = $(dos_so_ppc_specimens) $(elf_so_ppc_specimens) $(pe_so_ppc_specimens) $(raw_so_ppc_specimens)
any_so_x86_specimens = $(dos_so_x86_specimens) $(elf_so_x86_specimens) $(pe_so_x86_specimens) $(raw_so_x86_specimens)
any_core_amd64_specimens = $(dos_core_amd64_specimens) $(elf_core_amd64_specimens) $(pe_core_amd64_specimens) $(raw_core_amd64_specimens)
any_core_arm_specimens = $(dos_core_arm_specimens) $(elf_core_arm_specimens) $(pe_core_arm_specimens) $(raw_core_arm_specimens)
any_core_mips_specimens = $(dos_core_mips_specimens) $(elf_core_mips_specimens) $(pe_core_mips_specimens) $(raw_core_mips_specimens)
any_core_m68k_specimens = $(dos_core_m68k_specimens) $(elf_core_m68k_specimens) $(pe_core_m68k_specimens) $(raw_core_m68k_specimens)
any_core_ppc_specimens = $(dos_core_ppc_specimens) $(elf_core_ppc_specimens) $(pe_core_ppc_specimens) $(raw_core_ppc_specimens)
any_core_x86_specimens = $(dos_core_x86_specimens) $(elf_core_x86_specimens) $(pe_core_x86_specimens) $(raw_core_x86_specimens)
any_insns_amd64_specimens = $(dos_insns_amd64_specimens) $(elf_insns_amd64_specimens) $(pe_insns_amd64_specimens) $(raw_insns_amd64_specimens)
any_insns_arm_specimens = $(dos_insns_arm_specimens) $(elf_insns_arm_specimens) $(pe_insns_arm_specimens) $(raw_insns_arm_specimens)
any_insns_mips_specimens = $(dos_insns_mips_specimens) $(elf_insns_mips_specimens) $(pe_insns_mips_specimens) $(raw_insns_mips_specimens)
any_insns_m68k_specimens = $(dos_insns_m68k_specimens) $(elf_insns_m68k_specimens) $(pe_insns_m68k_specimens) $(raw_insns_m68k_specimens)
any_insns_ppc_specimens = $(dos_insns_ppc_specimens) $(elf_insns_ppc_specimens) $(pe_insns_ppc_specimens) $(raw_insns_ppc_specimens)
any_insns_x86_specimens = $(dos_insns_x86_specimens) $(elf_insns_x86_specimens) $(pe_insns_x86_specimens) $(raw_insns_x86_specimens)
any_rot13_amd64_specimens = $(dos_rot13_amd64_specimens) $(elf_rot13_amd64_specimens) $(pe_rot13_amd64_specimens) $(raw_rot13_amd64_specimens)
any_rot13_arm_specimens = $(dos_rot13_arm_specimens) $(elf_rot13_arm_specimens) $(pe_rot13_arm_specimens) $(raw_rot13_arm_specimens)
any_rot13_mips_specimens = $(dos_rot13_mips_specimens) $(elf_rot13_mips_specimens) $(pe_rot13_mips_specimens) $(raw_rot13_mips_specimens)
any_rot13_m68k_specimens = $(dos_rot13_m68k_specimens) $(elf_rot13_m68k_specimens) $(pe_rot13_m68k_specimens) $(raw_rot13_m68k_specimens)
any_rot13_ppc_specimens = $(dos_rot13_ppc_specimens) $(elf_rot13_ppc_specimens) $(pe_rot13_ppc_specimens) $(raw_rot13_ppc_specimens)
any_rot13_x86_specimens = $(dos_rot13_x86_specimens) $(elf_rot13_x86_specimens) $(pe_rot13_x86_specimens) $(raw_rot13_x86_specimens)

# Filetype agnostic
dos_any_amd64_specimens = $(dos_exe_amd64_specimens) $(dos_obj_amd64_specimens) $(dos_archive_amd64_specimens) $(dos_so_amd64_specimens) $(dos_core_amd64_specimens) $(dos_insns_amd64_specimens) $(dos_rot13_amd64_specimens)
dos_any_arm_specimens = $(dos_exe_arm_specimens) $(dos_obj_arm_specimens) $(dos_archive_arm_specimens) $(dos_so_arm_specimens) $(dos_core_arm_specimens) $(dos_insns_arm_specimens) $(dos_rot13_arm_specimens)
dos_any_mips_specimens = $(dos_exe_mips_specimens) $(dos_obj_mips_specimens) $(dos_archive_mips_specimens) $(dos_so_mips_specimens) $(dos_core_mips_specimens) $(dos_insns_mips_specimens) $(dos_rot13_mips_specimens)
dos_any_m68k_specimens = $(dos_exe_m68k_specimens) $(dos_obj_m68k_specimens) $(dos_archive_m68k_specimens) $(dos_so_m68k_specimens) $(dos_core_m68k_specimens) $(dos_insns_m68k_specimens) $(dos_rot13_m68k_specimens)
dos_any_ppc_specimens = $(dos_exe_ppc_specimens) $(dos_obj_ppc_specimens) $(dos_archive_ppc_specimens) $(dos_so_ppc_specimens) $(dos_core_ppc_specimens) $(dos_insns_ppc_specimens) $(dos_rot13_ppc_specimens)
dos_any_x86_specimens = $(dos_exe_x86_specimens) $(dos_obj_x86_specimens) $(dos_archive_x86_specimens) $(dos_so_x86_specimens) $(dos_core_x86_specimens) $(dos_insns_x86_specimens) $(dos_rot13_x86_specimens)
elf_any_amd64_specimens = $(elf_exe_amd64_specimens) $(elf_obj_amd64_specimens) $(elf_archive_amd64_specimens) $(elf_so_amd64_specimens) $(elf_core_amd64_specimens) $(elf_insns_amd64_specimens) $(elf_rot13_amd64_specimens)
elf_any_arm_specimens = $(elf_exe_arm_specimens) $(elf_obj_arm_specimens) $(elf_archive_arm_specimens) $(elf_so_arm_specimens) $(elf_core_arm_specimens) $(elf_insns_arm_specimens) $(elf_rot13_arm_specimens)
elf_any_mips_specimens = $(elf_exe_mips_specimens) $(elf_obj_mips_specimens) $(elf_archive_mips_specimens) $(elf_so_mips_specimens) $(elf_core_mips_specimens) $(elf_insns_mips_specimens) $(elf_rot13_mips_specimens)
elf_any_m68k_specimens = $(elf_exe_m68k_specimens) $(elf_obj_m68k_specimens) $(elf_archive_m68k_specimens) $(elf_so_m68k_specimens) $(elf_core_m68k_specimens) $(elf_insns_m68k_specimens) $(elf_rot13_m68k_specimens)
elf_any_ppc_specimens = $(elf_exe_ppc_specimens) $(elf_obj_ppc_specimens) $(elf_archive_ppc_specimens) $(elf_so_ppc_specimens) $(elf_core_ppc_specimens) $(elf_insns_ppc_specimens) $(elf_rot13_ppc_specimens)
elf_any_x86_specimens = $(elf_exe_x86_specimens) $(elf_obj_x86_specimens) $(elf_archive_x86_specimens) $(elf_so_x86_specimens) $(elf_core_x86_specimens) $(elf_insns_x86_specimens) $(elf_rot13_x86_specimens)
pe_any_amd64_specimens = $(pe_exe_amd64_specimens) $(pe_obj_amd64_specimens) $(pe_archive_amd64_specimens) $(pe_so_amd64_specimens) $(pe_core_amd64_specimens) $(pe_insns_amd64_specimens) $(pe_rot13_amd64_specimens)
pe_any_arm_specimens = $(pe_exe_arm_specimens) $(pe_obj_arm_specimens) $(pe_archive_arm_specimens) $(pe_so_arm_specimens) $(pe_core_arm_specimens) $(pe_insns_arm_specimens) $(pe_rot13_arm_specimens)
pe_any_mips_specimens = $(pe_exe_mips_specimens) $(pe_obj_mips_specimens) $(pe_archive_mips_specimens) $(pe_so_mips_specimens) $(pe_core_mips_specimens) $(pe_insns_mips_specimens) $(pe_rot13_mips_specimens)
pe_any_m68k_specimens = $(pe_exe_m68k_specimens) $(pe_obj_m68k_specimens) $(pe_archive_m68k_specimens) $(pe_so_m68k_specimens) $(pe_core_m68k_specimens) $(pe_insns_m68k_specimens) $(pe_rot13_m68k_specimens)
pe_any_ppc_specimens = $(pe_exe_ppc_specimens) $(pe_obj_ppc_specimens) $(pe_archive_ppc_specimens) $(pe_so_ppc_specimens) $(pe_core_ppc_specimens) $(pe_insns_ppc_specimens) $(pe_rot13_ppc_specimens)
pe_any_x86_specimens = $(pe_exe_x86_specimens) $(pe_obj_x86_specimens) $(pe_archive_x86_specimens) $(pe_so_x86_specimens) $(pe_core_x86_specimens) $(pe_insns_x86_specimens) $(pe_rot13_x86_specimens)
raw_any_amd64_specimens = $(raw_exe_amd64_specimens) $(raw_obj_amd64_specimens) $(raw_archive_amd64_specimens) $(raw_so_amd64_specimens) $(raw_core_amd64_specimens) $(raw_insns_amd64_specimens) $(raw_rot13_amd64_specimens)
raw_any_arm_specimens = $(raw_exe_arm_specimens) $(raw_obj_arm_specimens) $(raw_archive_arm_specimens) $(raw_so_arm_specimens) $(raw_core_arm_specimens) $(raw_insns_arm_specimens) $(raw_rot13_arm_specimens)
raw_any_mips_specimens = $(raw_exe_mips_specimens) $(raw_obj_mips_specimens) $(raw_archive_mips_specimens) $(raw_so_mips_specimens) $(raw_core_mips_specimens) $(raw_insns_mips_specimens) $(raw_rot13_mips_specimens)
raw_any_m68k_specimens = $(raw_exe_m68k_specimens) $(raw_obj_m68k_specimens) $(raw_archive_m68k_specimens) $(raw_so_m68k_specimens) $(raw_core_m68k_specimens) $(raw_insns_m68k_specimens) $(raw_rot13_m68k_specimens)
raw_any_ppc_specimens = $(raw_exe_ppc_specimens) $(raw_obj_ppc_specimens) $(raw_archive_ppc_specimens) $(raw_so_ppc_specimens) $(raw_core_ppc_specimens) $(raw_insns_ppc_specimens) $(raw_rot13_ppc_specimens)
raw_any_x86_specimens = $(raw_exe_x86_specimens) $(raw_obj_x86_specimens) $(raw_archive_x86_specimens) $(raw_so_x86_specimens) $(raw_core_x86_specimens) $(raw_insns_x86_specimens) $(raw_rot13_x86_specimens)

# Architecture agnostic
dos_exe_any_specimens = $(dos_exe_amd64_specimens) $(dos_exe_arm_specimens) $(dos_exe_mips_specimens) $(dos_exe_m68k_specimens) $(dos_exe_ppc_specimens) $(dos_exe_x86_specimens)
dos_obj_any_specimens = $(dos_obj_amd64_specimens) $(dos_obj_arm_specimens) $(dos_obj_mips_specimens) $(dos_obj_m68k_specimens) $(dos_obj_ppc_specimens) $(dos_obj_x86_specimens)
dos_archive_any_specimens = $(dos_archive_amd64_specimens) $(dos_archive_arm_specimens) $(dos_archive_mips_specimens) $(dos_archive_m68k_specimens) $(dos_archive_ppc_specimens) $(dos_archive_x86_specimens)
dos_so_any_specimens = $(dos_so_amd64_specimens) $(dos_so_arm_specimens) $(dos_so_mips_specimens) $(dos_so_m68k_specimens) $(dos_so_ppc_specimens) $(dos_so_x86_specimens)
dos_core_any_specimens = $(dos_core_amd64_specimens) $(dos_core_arm_specimens) $(dos_core_mips_specimens) $(dos_core_m68k_specimens) $(dos_core_ppc_specimens) $(dos_core_x86_specimens)
dos_insns_any_specimens = $(dos_insns_amd64_specimens) $(dos_insns_arm_specimens) $(dos_insns_mips_specimens) $(dos_insns_m68k_specimens) $(dos_insns_ppc_specimens) $(dos_insns_x86_specimens)
dos_rot13_any_specimens = $(dos_rot13_amd64_specimens) $(dos_rot13_arm_specimens) $(dos_rot13_mips_specimens) $(dos_rot13_m68k_specimens) $(dos_rot13_ppc_specimens) $(dos_rot13_x86_specimens)
elf_exe_any_specimens = $(elf_exe_amd64_specimens) $(elf_exe_arm_specimens) $(elf_exe_mips_specimens) $(elf_exe_m68k_specimens) $(elf_exe_ppc_specimens) $(elf_exe_x86_specimens)
elf_obj_any_specimens = $(elf_obj_amd64_specimens) $(elf_obj_arm_specimens) $(elf_obj_mips_specimens) $(elf_obj_m68k_specimens) $(elf_obj_ppc_specimens) $(elf_obj_x86_specimens)
elf_archive_any_specimens = $(elf_archive_amd64_specimens) $(elf_archive_arm_specimens) $(elf_archive_mips_specimens) $(elf_archive_m68k_specimens) $(elf_archive_ppc_specimens) $(elf_archive_x86_specimens)
elf_so_any_specimens = $(elf_so_amd64_specimens) $(elf_so_arm_specimens) $(elf_so_mips_specimens) $(elf_so_m68k_specimens) $(elf_so_ppc_specimens) $(elf_so_x86_specimens)
elf_core_any_specimens = $(elf_core_amd64_specimens) $(elf_core_arm_specimens) $(elf_core_mips_specimens) $(elf_core_m68k_specimens) $(elf_core_ppc_specimens) $(elf_core_x86_specimens)
elf_insns_any_specimens = $(elf_insns_amd64_specimens) $(elf_insns_arm_specimens) $(elf_insns_mips_specimens) $(elf_insns_m68k_specimens) $(elf_insns_ppc_specimens) $(elf_insns_x86_specimens)
elf_rot13_any_specimens = $(elf_rot13_amd64_specimens) $(elf_rot13_arm_specimens) $(elf_rot13_mips_specimens) $(elf_rot13_m68k_specimens) $(elf_rot13_ppc_specimens) $(elf_rot13_x86_specimens)
pe_exe_any_specimens = $(pe_exe_amd64_specimens) $(pe_exe_arm_specimens) $(pe_exe_mips_specimens) $(pe_exe_m68k_specimens) $(pe_exe_ppc_specimens) $(pe_exe_x86_specimens)
pe_obj_any_specimens = $(pe_obj_amd64_specimens) $(pe_obj_arm_specimens) $(pe_obj_mips_specimens) $(pe_obj_m68k_specimens) $(pe_obj_ppc_specimens) $(pe_obj_x86_specimens)
pe_archive_any_specimens = $(pe_archive_amd64_specimens) $(pe_archive_arm_specimens) $(pe_archive_mips_specimens) $(pe_archive_m68k_specimens) $(pe_archive_ppc_specimens) $(pe_archive_x86_specimens)
pe_so_any_specimens = $(pe_so_amd64_specimens) $(pe_so_arm_specimens) $(pe_so_mips_specimens) $(pe_so_m68k_specimens) $(pe_so_ppc_specimens) $(pe_so_x86_specimens)
pe_core_any_specimens = $(pe_core_amd64_specimens) $(pe_core_arm_specimens) $(pe_core_mips_specimens) $(pe_core_m68k_specimens) $(pe_core_ppc_specimens) $(pe_core_x86_specimens)
pe_insns_any_specimens = $(pe_insns_amd64_specimens) $(pe_insns_arm_specimens) $(pe_insns_mips_specimens) $(pe_insns_m68k_specimens) $(pe_insns_ppc_specimens) $(pe_insns_x86_specimens)
pe_rot13_any_specimens = $(pe_rot13_amd64_specimens) $(pe_rot13_arm_specimens) $(pe_rot13_mips_specimens) $(pe_rot13_m68k_specimens) $(pe_rot13_ppc_specimens) $(pe_rot13_x86_specimens)
raw_exe_any_specimens = $(raw_exe_amd64_specimens) $(raw_exe_arm_specimens) $(raw_exe_mips_specimens) $(raw_exe_m68k_specimens) $(raw_exe_ppc_specimens) $(raw_exe_x86_specimens)
raw_obj_any_specimens = $(raw_obj_amd64_specimens) $(raw_obj_arm_specimens) $(raw_obj_mips_specimens) $(raw_obj_m68k_specimens) $(raw_obj_ppc_specimens) $(raw_obj_x86_specimens)
raw_archive_any_specimens = $(raw_archive_amd64_specimens) $(raw_archive_arm_specimens) $(raw_archive_mips_specimens) $(raw_archive_m68k_specimens) $(raw_archive_ppc_specimens) $(raw_archive_x86_specimens)
raw_so_any_specimens = $(raw_so_amd64_specimens) $(raw_so_arm_specimens) $(raw_so_mips_specimens) $(raw_so_m68k_specimens) $(raw_so_ppc_specimens) $(raw_so_x86_specimens)
raw_core_any_specimens = $(raw_core_amd64_specimens) $(raw_core_arm_specimens) $(raw_core_mips_specimens) $(raw_core_m68k_specimens) $(raw_core_ppc_specimens) $(raw_core_x86_specimens)
raw_insns_any_specimens = $(raw_insns_amd64_specimens) $(raw_insns_arm_specimens) $(raw_insns_mips_specimens) $(raw_insns_m68k_specimens) $(raw_insns_ppc_specimens) $(raw_insns_x86_specimens)
raw_rot13_any_specimens = $(raw_rot13_amd64_specimens) $(raw_rot13_arm_specimens) $(raw_rot13_mips_specimens) $(raw_rot13_m68k_specimens) $(raw_rot13_ppc_specimens) $(raw_rot13_x86_specimens)

# Filetype and architecture agnostic
dos_any_any_specimens = $(dos_exe_amd64_specimens) $(dos_exe_arm_specimens) $(dos_exe_mips_specimens) $(dos_exe_m68k_specimens) $(dos_exe_ppc_specimens) $(dos_exe_x86_specimens) $(dos_obj_amd64_specimens) $(dos_obj_arm_specimens) $(dos_obj_mips_specimens) $(dos_obj_m68k_specimens) $(dos_obj_ppc_specimens) $(dos_obj_x86_specimens) $(dos_archive_amd64_specimens) $(dos_archive_arm_specimens) $(dos_archive_mips_specimens) $(dos_archive_m68k_specimens) $(dos_archive_ppc_specimens) $(dos_archive_x86_specimens) $(dos_so_amd64_specimens) $(dos_so_arm_specimens) $(dos_so_mips_specimens) $(dos_so_m68k_specimens) $(dos_so_ppc_specimens) $(dos_so_x86_specimens) $(dos_core_amd64_specimens) $(dos_core_arm_specimens) $(dos_core_mips_specimens) $(dos_core_m68k_specimens) $(dos_core_ppc_specimens) $(dos_core_x86_specimens) $(dos_insns_amd64_specimens) $(dos_insns_arm_specimens) $(dos_insns_mips_specimens) $(dos_insns_m68k_specimens) $(dos_insns_ppc_specimens) $(dos_insns_x86_specimens) $(dos_rot13_amd64_specimens) $(dos_rot13_arm_specimens) $(dos_rot13_mips_specimens) $(dos_rot13_m68k_specimens) $(dos_rot13_ppc_specimens) $(dos_rot13_x86_specimens)
elf_any_any_specimens = $(elf_exe_amd64_specimens) $(elf_exe_arm_specimens) $(elf_exe_mips_specimens) $(elf_exe_m68k_specimens) $(elf_exe_ppc_specimens) $(elf_exe_x86_specimens) $(elf_obj_amd64_specimens) $(elf_obj_arm_specimens) $(elf_obj_mips_specimens) $(elf_obj_m68k_specimens) $(elf_obj_ppc_specimens) $(elf_obj_x86_specimens) $(elf_archive_amd64_specimens) $(elf_archive_arm_specimens) $(elf_archive_mips_specimens) $(elf_archive_m68k_specimens) $(elf_archive_ppc_specimens) $(elf_archive_x86_specimens) $(elf_so_amd64_specimens) $(elf_so_arm_specimens) $(elf_so_mips_specimens) $(elf_so_m68k_specimens) $(elf_so_ppc_specimens) $(elf_so_x86_specimens) $(elf_core_amd64_specimens) $(elf_core_arm_specimens) $(elf_core_mips_specimens) $(elf_core_m68k_specimens) $(elf_core_ppc_specimens) $(elf_core_x86_specimens) $(elf_insns_amd64_specimens) $(elf_insns_arm_specimens) $(elf_insns_mips_specimens) $(elf_insns_m68k_specimens) $(elf_insns_ppc_specimens) $(elf_insns_x86_specimens) $(elf_rot13_amd64_specimens) $(elf_rot13_arm_specimens) $(elf_rot13_mips_specimens) $(elf_rot13_m68k_specimens) $(elf_rot13_ppc_specimens) $(elf_rot13_x86_specimens)
pe_any_any_specimens = $(pe_exe_amd64_specimens) $(pe_exe_arm_specimens) $(pe_exe_mips_specimens) $(pe_exe_m68k_specimens) $(pe_exe_ppc_specimens) $(pe_exe_x86_specimens) $(pe_obj_amd64_specimens) $(pe_obj_arm_specimens) $(pe_obj_mips_specimens) $(pe_obj_m68k_specimens) $(pe_obj_ppc_specimens) $(pe_obj_x86_specimens) $(pe_archive_amd64_specimens) $(pe_archive_arm_specimens) $(pe_archive_mips_specimens) $(pe_archive_m68k_specimens) $(pe_archive_ppc_specimens) $(pe_archive_x86_specimens) $(pe_so_amd64_specimens) $(pe_so_arm_specimens) $(pe_so_mips_specimens) $(pe_so_m68k_specimens) $(pe_so_ppc_specimens) $(pe_so_x86_specimens) $(pe_core_amd64_specimens) $(pe_core_arm_specimens) $(pe_core_mips_specimens) $(pe_core_m68k_specimens) $(pe_core_ppc_specimens) $(pe_core_x86_specimens) $(pe_insns_amd64_specimens) $(pe_insns_arm_specimens) $(pe_insns_mips_specimens) $(pe_insns_m68k_specimens) $(pe_insns_ppc_specimens) $(pe_insns_x86_specimens) $(pe_rot13_amd64_specimens) $(pe_rot13_arm_specimens) $(pe_rot13_mips_specimens) $(pe_rot13_m68k_specimens) $(pe_rot13_ppc_specimens) $(pe_rot13_x86_specimens)
raw_any_any_specimens = $(raw_exe_amd64_specimens) $(raw_exe_arm_specimens) $(raw_exe_mips_specimens) $(raw_exe_m68k_specimens) $(raw_exe_ppc_specimens) $(raw_exe_x86_specimens) $(raw_obj_amd64_specimens) $(raw_obj_arm_specimens) $(raw_obj_mips_specimens) $(raw_obj_m68k_specimens) $(raw_obj_ppc_specimens) $(raw_obj_x86_specimens) $(raw_archive_amd64_specimens) $(raw_archive_arm_specimens) $(raw_archive_mips_specimens) $(raw_archive_m68k_specimens) $(raw_archive_ppc_specimens) $(raw_archive_x86_specimens) $(raw_so_amd64_specimens) $(raw_so_arm_specimens) $(raw_so_mips_specimens) $(raw_so_m68k_specimens) $(raw_so_ppc_specimens) $(raw_so_x86_specimens) $(raw_core_amd64_specimens) $(raw_core_arm_specimens) $(raw_core_mips_specimens) $(raw_core_m68k_specimens) $(raw_core_ppc_specimens) $(raw_core_x86_specimens) $(raw_insns_amd64_specimens) $(raw_insns_arm_specimens) $(raw_insns_mips_specimens) $(raw_insns_m68k_specimens) $(raw_insns_ppc_specimens) $(raw_insns_x86_specimens) $(raw_rot13_amd64_specimens) $(raw_rot13_arm_specimens) $(raw_rot13_mips_specimens) $(raw_rot13_m68k_specimens) $(raw_rot13_ppc_specimens) $(raw_rot13_x86_specimens)

# Container and architecture agnostic
any_exe_any_specimens = $(dos_exe_amd64_specimens) $(dos_exe_arm_specimens) $(dos_exe_mips_specimens) $(dos_exe_m68k_specimens) $(dos_exe_ppc_specimens) $(dos_exe_x86_specimens) $(elf_exe_amd64_specimens) $(elf_exe_arm_specimens) $(elf_exe_mips_specimens) $(elf_exe_m68k_specimens) $(elf_exe_ppc_specimens) $(elf_exe_x86_specimens) $(pe_exe_amd64_specimens) $(pe_exe_arm_specimens) $(pe_exe_mips_specimens) $(pe_exe_m68k_specimens) $(pe_exe_ppc_specimens) $(pe_exe_x86_specimens) $(raw_exe_amd64_specimens) $(raw_exe_arm_specimens) $(raw_exe_mips_specimens) $(raw_exe_m68k_specimens) $(raw_exe_ppc_specimens) $(raw_exe_x86_specimens)
any_obj_any_specimens = $(dos_obj_amd64_specimens) $(dos_obj_arm_specimens) $(dos_obj_mips_specimens) $(dos_obj_m68k_specimens) $(dos_obj_ppc_specimens) $(dos_obj_x86_specimens) $(elf_obj_amd64_specimens) $(elf_obj_arm_specimens) $(elf_obj_mips_specimens) $(elf_obj_m68k_specimens) $(elf_obj_ppc_specimens) $(elf_obj_x86_specimens) $(pe_obj_amd64_specimens) $(pe_obj_arm_specimens) $(pe_obj_mips_specimens) $(pe_obj_m68k_specimens) $(pe_obj_ppc_specimens) $(pe_obj_x86_specimens) $(raw_obj_amd64_specimens) $(raw_obj_arm_specimens) $(raw_obj_mips_specimens) $(raw_obj_m68k_specimens) $(raw_obj_ppc_specimens) $(raw_obj_x86_specimens)
any_archive_any_specimens = $(dos_archive_amd64_specimens) $(dos_archive_arm_specimens) $(dos_archive_mips_specimens) $(dos_archive_m68k_specimens) $(dos_archive_ppc_specimens) $(dos_archive_x86_specimens) $(elf_archive_amd64_specimens) $(elf_archive_arm_specimens) $(elf_archive_mips_specimens) $(elf_archive_m68k_specimens) $(elf_archive_ppc_specimens) $(elf_archive_x86_specimens) $(pe_archive_amd64_specimens) $(pe_archive_arm_specimens) $(pe_archive_mips_specimens) $(pe_archive_m68k_specimens) $(pe_archive_ppc_specimens) $(pe_archive_x86_specimens) $(raw_archive_amd64_specimens) $(raw_archive_arm_specimens) $(raw_archive_mips_specimens) $(raw_archive_m68k_specimens) $(raw_archive_ppc_specimens) $(raw_archive_x86_specimens)
any_so_any_specimens = $(dos_so_amd64_specimens) $(dos_so_arm_specimens) $(dos_so_mips_specimens) $(dos_so_m68k_specimens) $(dos_so_ppc_specimens) $(dos_so_x86_specimens) $(elf_so_amd64_specimens) $(elf_so_arm_specimens) $(elf_so_mips_specimens) $(elf_so_m68k_specimens) $(elf_so_ppc_specimens) $(elf_so_x86_specimens) $(pe_so_amd64_specimens) $(pe_so_arm_specimens) $(pe_so_mips_specimens) $(pe_so_m68k_specimens) $(pe_so_ppc_specimens) $(pe_so_x86_specimens) $(raw_so_amd64_specimens) $(raw_so_arm_specimens) $(raw_so_mips_specimens) $(raw_so_m68k_specimens) $(raw_so_ppc_specimens) $(raw_so_x86_specimens)
any_core_any_specimens = $(dos_core_amd64_specimens) $(dos_core_arm_specimens) $(dos_core_mips_specimens) $(dos_core_m68k_specimens) $(dos_core_ppc_specimens) $(dos_core_x86_specimens) $(elf_core_amd64_specimens) $(elf_core_arm_specimens) $(elf_core_mips_specimens) $(elf_core_m68k_specimens) $(elf_core_ppc_specimens) $(elf_core_x86_specimens) $(pe_core_amd64_specimens) $(pe_core_arm_specimens) $(pe_core_mips_specimens) $(pe_core_m68k_specimens) $(pe_core_ppc_specimens) $(pe_core_x86_specimens) $(raw_core_amd64_specimens) $(raw_core_arm_specimens) $(raw_core_mips_specimens) $(raw_core_m68k_specimens) $(raw_core_ppc_specimens) $(raw_core_x86_specimens)
any_insns_any_specimens = $(dos_insns_amd64_specimens) $(dos_insns_arm_specimens) $(dos_insns_mips_specimens) $(dos_insns_m68k_specimens) $(dos_insns_ppc_specimens) $(dos_insns_x86_specimens) $(elf_insns_amd64_specimens) $(elf_insns_arm_specimens) $(elf_insns_mips_specimens) $(elf_insns_m68k_specimens) $(elf_insns_ppc_specimens) $(elf_insns_x86_specimens) $(pe_insns_amd64_specimens) $(pe_insns_arm_specimens) $(pe_insns_mips_specimens) $(pe_insns_m68k_specimens) $(pe_insns_ppc_specimens) $(pe_insns_x86_specimens) $(raw_insns_amd64_specimens) $(raw_insns_arm_specimens) $(raw_insns_mips_specimens) $(raw_insns_m68k_specimens) $(raw_insns_ppc_specimens) $(raw_insns_x86_specimens)
any_rot13_any_specimens = $(dos_rot13_amd64_specimens) $(dos_rot13_arm_specimens) $(dos_rot13_mips_specimens) $(dos_rot13_m68k_specimens) $(dos_rot13_ppc_specimens) $(dos_rot13_x86_specimens) $(elf_rot13_amd64_specimens) $(elf_rot13_arm_specimens) $(elf_rot13_mips_specimens) $(elf_rot13_m68k_specimens) $(elf_rot13_ppc_specimens) $(elf_rot13_x86_specimens) $(pe_rot13_amd64_specimens) $(pe_rot13_arm_specimens) $(pe_rot13_mips_specimens) $(pe_rot13_m68k_specimens) $(pe_rot13_ppc_specimens) $(pe_rot13_x86_specimens) $(raw_rot13_amd64_specimens) $(raw_rot13_arm_specimens) $(raw_rot13_mips_specimens) $(raw_rot13_m68k_specimens) $(raw_rot13_ppc_specimens) $(raw_rot13_x86_specimens)

# Container and filetype agnostic
any_any_amd64_specimens = $(dos_exe_amd64_specimens) $(dos_obj_amd64_specimens) $(dos_archive_amd64_specimens) $(dos_so_amd64_specimens) $(dos_core_amd64_specimens) $(dos_insns_amd64_specimens) $(dos_rot13_amd64_specimens) $(elf_exe_amd64_specimens) $(elf_obj_amd64_specimens) $(elf_archive_amd64_specimens) $(elf_so_amd64_specimens) $(elf_core_amd64_specimens) $(elf_insns_amd64_specimens) $(elf_rot13_amd64_specimens) $(pe_exe_amd64_specimens) $(pe_obj_amd64_specimens) $(pe_archive_amd64_specimens) $(pe_so_amd64_specimens) $(pe_core_amd64_specimens) $(pe_insns_amd64_specimens) $(pe_rot13_amd64_specimens) $(raw_exe_amd64_specimens) $(raw_obj_amd64_specimens) $(raw_archive_amd64_specimens) $(raw_so_amd64_specimens) $(raw_core_amd64_specimens) $(raw_insns_amd64_specimens) $(raw_rot13_amd64_specimens)
any_any_arm_specimens = $(dos_exe_arm_specimens) $(dos_obj_arm_specimens) $(dos_archive_arm_specimens) $(dos_so_arm_specimens) $(dos_core_arm_specimens) $(dos_insns_arm_specimens) $(dos_rot13_arm_specimens) $(elf_exe_arm_specimens) $(elf_obj_arm_specimens) $(elf_archive_arm_specimens) $(elf_so_arm_specimens) $(elf_core_arm_specimens) $(elf_insns_arm_specimens) $(elf_rot13_arm_specimens) $(pe_exe_arm_specimens) $(pe_obj_arm_specimens) $(pe_archive_arm_specimens) $(pe_so_arm_specimens) $(pe_core_arm_specimens) $(pe_insns_arm_specimens) $(pe_rot13_arm_specimens) $(raw_exe_arm_specimens) $(raw_obj_arm_specimens) $(raw_archive_arm_specimens) $(raw_so_arm_specimens) $(raw_core_arm_specimens) $(raw_insns_arm_specimens) $(raw_rot13_arm_specimens)
any_any_mips_specimens = $(dos_exe_mips_specimens) $(dos_obj_mips_specimens) $(dos_archive_mips_specimens) $(dos_so_mips_specimens) $(dos_core_mips_specimens) $(dos_insns_mips_specimens) $(dos_rot13_mips_specimens) $(elf_exe_mips_specimens) $(elf_obj_mips_specimens) $(elf_archive_mips_specimens) $(elf_so_mips_specimens) $(elf_core_mips_specimens) $(elf_insns_mips_specimens) $(elf_rot13_mips_specimens) $(pe_exe_mips_specimens) $(pe_obj_mips_specimens) $(pe_archive_mips_specimens) $(pe_so_mips_specimens) $(pe_core_mips_specimens) $(pe_insns_mips_specimens) $(pe_rot13_mips_specimens) $(raw_exe_mips_specimens) $(raw_obj_mips_specimens) $(raw_archive_mips_specimens) $(raw_so_mips_specimens) $(raw_core_mips_specimens) $(raw_insns_mips_specimens) $(raw_rot13_mips_specimens)
any_any_m68k_specimens = $(dos_exe_m68k_specimens) $(dos_obj_m68k_specimens) $(dos_archive_m68k_specimens) $(dos_so_m68k_specimens) $(dos_core_m68k_specimens) $(dos_insns_m68k_specimens) $(dos_rot13_m68k_specimens) $(elf_exe_m68k_specimens) $(elf_obj_m68k_specimens) $(elf_archive_m68k_specimens) $(elf_so_m68k_specimens) $(elf_core_m68k_specimens) $(elf_insns_m68k_specimens) $(elf_rot13_m68k_specimens) $(pe_exe_m68k_specimens) $(pe_obj_m68k_specimens) $(pe_archive_m68k_specimens) $(pe_so_m68k_specimens) $(pe_core_m68k_specimens) $(pe_insns_m68k_specimens) $(pe_rot13_m68k_specimens) $(raw_exe_m68k_specimens) $(raw_obj_m68k_specimens) $(raw_archive_m68k_specimens) $(raw_so_m68k_specimens) $(raw_core_m68k_specimens) $(raw_insns_m68k_specimens) $(raw_rot13_m68k_specimens)
any_any_ppc_specimens = $(dos_exe_ppc_specimens) $(dos_obj_ppc_specimens) $(dos_archive_ppc_specimens) $(dos_so_ppc_specimens) $(dos_core_ppc_specimens) $(dos_insns_ppc_specimens) $(dos_rot13_ppc_specimens) $(elf_exe_ppc_specimens) $(elf_obj_ppc_specimens) $(elf_archive_ppc_specimens) $(elf_so_ppc_specimens) $(elf_core_ppc_specimens) $(elf_insns_ppc_specimens) $(elf_rot13_ppc_specimens) $(pe_exe_ppc_specimens) $(pe_obj_ppc_specimens) $(pe_archive_ppc_specimens) $(pe_so_ppc_specimens) $(pe_core_ppc_specimens) $(pe_insns_ppc_specimens) $(pe_rot13_ppc_specimens) $(raw_exe_ppc_specimens) $(raw_obj_ppc_specimens) $(raw_archive_ppc_specimens) $(raw_so_ppc_specimens) $(raw_core_ppc_specimens) $(raw_insns_ppc_specimens) $(raw_rot13_ppc_specimens)
any_any_x86_specimens = $(dos_exe_x86_specimens) $(dos_obj_x86_specimens) $(dos_archive_x86_specimens) $(dos_so_x86_specimens) $(dos_core_x86_specimens) $(dos_insns_x86_specimens) $(dos_rot13_x86_specimens) $(elf_exe_x86_specimens) $(elf_obj_x86_specimens) $(elf_archive_x86_specimens) $(elf_so_x86_specimens) $(elf_core_x86_specimens) $(elf_insns_x86_specimens) $(elf_rot13_x86_specimens) $(pe_exe_x86_specimens) $(pe_obj_x86_specimens) $(pe_archive_x86_specimens) $(pe_so_x86_specimens) $(pe_core_x86_specimens) $(pe_insns_x86_specimens) $(pe_rot13_x86_specimens) $(raw_exe_x86_specimens) $(raw_obj_x86_specimens) $(raw_archive_x86_specimens) $(raw_so_x86_specimens) $(raw_core_x86_specimens) $(raw_insns_x86_specimens) $(raw_rot13_x86_specimens)

# All binary specimens
any_any_any_specimens = $(dos_exe_amd64_specimens) $(dos_exe_arm_specimens) $(dos_exe_mips_specimens) $(dos_exe_m68k_specimens) $(dos_exe_ppc_specimens) $(dos_exe_x86_specimens) $(dos_obj_amd64_specimens) $(dos_obj_arm_specimens) $(dos_obj_mips_specimens) $(dos_obj_m68k_specimens) $(dos_obj_ppc_specimens) $(dos_obj_x86_specimens) $(dos_archive_amd64_specimens) $(dos_archive_arm_specimens) $(dos_archive_mips_specimens) $(dos_archive_m68k_specimens) $(dos_archive_ppc_specimens) $(dos_archive_x86_specimens) $(dos_so_amd64_specimens) $(dos_so_arm_specimens) $(dos_so_mips_specimens) $(dos_so_m68k_specimens) $(dos_so_ppc_specimens) $(dos_so_x86_specimens) $(dos_core_amd64_specimens) $(dos_core_arm_specimens) $(dos_core_mips_specimens) $(dos_core_m68k_specimens) $(dos_core_ppc_specimens) $(dos_core_x86_specimens) $(dos_insns_amd64_specimens) $(dos_insns_arm_specimens) $(dos_insns_mips_specimens) $(dos_insns_m68k_specimens) $(dos_insns_ppc_specimens) $(dos_insns_x86_specimens) $(dos_rot13_amd64_specimens) $(dos_rot13_arm_specimens) $(dos_rot13_mips_specimens) $(dos_rot13_m68k_specimens) $(dos_rot13_ppc_specimens) $(dos_rot13_x86_specimens) $(elf_exe_amd64_specimens) $(elf_exe_arm_specimens) $(elf_exe_mips_specimens) $(elf_exe_m68k_specimens) $(elf_exe_ppc_specimens) $(elf_exe_x86_specimens) $(elf_obj_amd64_specimens) $(elf_obj_arm_specimens) $(elf_obj_mips_specimens) $(elf_obj_m68k_specimens) $(elf_obj_ppc_specimens) $(elf_obj_x86_specimens) $(elf_archive_amd64_specimens) $(elf_archive_arm_specimens) $(elf_archive_mips_specimens) $(elf_archive_m68k_specimens) $(elf_archive_ppc_specimens) $(elf_archive_x86_specimens) $(elf_so_amd64_specimens) $(elf_so_arm_specimens) $(elf_so_mips_specimens) $(elf_so_m68k_specimens) $(elf_so_ppc_specimens) $(elf_so_x86_specimens) $(elf_core_amd64_specimens) $(elf_core_arm_specimens) $(elf_core_mips_specimens) $(elf_core_m68k_specimens) $(elf_core_ppc_specimens) $(elf_core_x86_specimens) $(elf_insns_amd64_specimens) $(elf_insns_arm_specimens) $(elf_insns_mips_specimens) $(elf_insns_m68k_specimens) $(elf_insns_ppc_specimens) $(elf_insns_x86_specimens) $(elf_rot13_amd64_specimens) $(elf_rot13_arm_specimens) $(elf_rot13_mips_specimens) $(elf_rot13_m68k_specimens) $(elf_rot13_ppc_specimens) $(elf_rot13_x86_specimens) $(pe_exe_amd64_specimens) $(pe_exe_arm_specimens) $(pe_exe_mips_specimens) $(pe_exe_m68k_specimens) $(pe_exe_ppc_specimens) $(pe_exe_x86_specimens) $(pe_obj_amd64_specimens) $(pe_obj_arm_specimens) $(pe_obj_mips_specimens) $(pe_obj_m68k_specimens) $(pe_obj_ppc_specimens) $(pe_obj_x86_specimens) $(pe_archive_amd64_specimens) $(pe_archive_arm_specimens) $(pe_archive_mips_specimens) $(pe_archive_m68k_specimens) $(pe_archive_ppc_specimens) $(pe_archive_x86_specimens) $(pe_so_amd64_specimens) $(pe_so_arm_specimens) $(pe_so_mips_specimens) $(pe_so_m68k_specimens) $(pe_so_ppc_specimens) $(pe_so_x86_specimens) $(pe_core_amd64_specimens) $(pe_core_arm_specimens) $(pe_core_mips_specimens) $(pe_core_m68k_specimens) $(pe_core_ppc_specimens) $(pe_core_x86_specimens) $(pe_insns_amd64_specimens) $(pe_insns_arm_specimens) $(pe_insns_mips_specimens) $(pe_insns_m68k_specimens) $(pe_insns_ppc_specimens) $(pe_insns_x86_specimens) $(pe_rot13_amd64_specimens) $(pe_rot13_arm_specimens) $(pe_rot13_mips_specimens) $(pe_rot13_m68k_specimens) $(pe_rot13_ppc_specimens) $(pe_rot13_x86_specimens) $(raw_exe_amd64_specimens) $(raw_exe_arm_specimens) $(raw_exe_mips_specimens) $(raw_exe_m68k_specimens) $(raw_exe_ppc_specimens) $(raw_exe_x86_specimens) $(raw_obj_amd64_specimens) $(raw_obj_arm_specimens) $(raw_obj_mips_specimens) $(raw_obj_m68k_specimens) $(raw_obj_ppc_specimens) $(raw_obj_x86_specimens) $(raw_archive_amd64_specimens) $(raw_archive_arm_specimens) $(raw_archive_mips_specimens) $(raw_archive_m68k_specimens) $(raw_archive_ppc_specimens) $(raw_archive_x86_specimens) $(raw_so_amd64_specimens) $(raw_so_arm_specimens) $(raw_so_mips_specimens) $(raw_so_m68k_specimens) $(raw_so_ppc_specimens) $(raw_so_x86_specimens) $(raw_core_amd64_specimens) $(raw_core_arm_specimens) $(raw_core_mips_specimens) $(raw_core_m68k_specimens) $(raw_core_ppc_specimens) $(raw_core_x86_specimens) $(raw_insns_amd64_specimens) $(raw_insns_arm_specimens) $(raw_insns_mips_specimens) $(raw_insns_m68k_specimens) $(raw_insns_ppc_specimens) $(raw_insns_x86_specimens) $(raw_rot13_amd64_specimens) $(raw_rot13_arm_specimens) $(raw_rot13_mips_specimens) $(raw_rot13_m68k_specimens) $(raw_rot13_ppc_specimens) $(raw_rot13_x86_specimens)

/* This file is automatically generated from ./run_me_caller_generator.sh 
 * Maximum number of subroutine parameters is 256 
 * To regenerate run_me_defs.inc, type ./ > run_me_defs.inc */
      case 1:
            XOMP_parallel_start (run_me_1, (void*) g_parameter, *numThread);
            break; 
      case 2:
            XOMP_parallel_start (run_me_2, (void*) g_parameter, *numThread);
            break; 
      case 3:
            XOMP_parallel_start (run_me_3, (void*) g_parameter, *numThread);
            break; 
      case 4:
            XOMP_parallel_start (run_me_4, (void*) g_parameter, *numThread);
            break; 
      case 5:
            XOMP_parallel_start (run_me_5, (void*) g_parameter, *numThread);
            break; 
      case 6:
            XOMP_parallel_start (run_me_6, (void*) g_parameter, *numThread);
            break; 
      case 7:
            XOMP_parallel_start (run_me_7, (void*) g_parameter, *numThread);
            break; 
      case 8:
            XOMP_parallel_start (run_me_8, (void*) g_parameter, *numThread);
            break; 
      case 9:
            XOMP_parallel_start (run_me_9, (void*) g_parameter, *numThread);
            break; 
      case 10:
            XOMP_parallel_start (run_me_10, (void*) g_parameter, *numThread);
            break; 
      case 11:
            XOMP_parallel_start (run_me_11, (void*) g_parameter, *numThread);
            break; 
      case 12:
            XOMP_parallel_start (run_me_12, (void*) g_parameter, *numThread);
            break; 
      case 13:
            XOMP_parallel_start (run_me_13, (void*) g_parameter, *numThread);
            break; 
      case 14:
            XOMP_parallel_start (run_me_14, (void*) g_parameter, *numThread);
            break; 
      case 15:
            XOMP_parallel_start (run_me_15, (void*) g_parameter, *numThread);
            break; 
      case 16:
            XOMP_parallel_start (run_me_16, (void*) g_parameter, *numThread);
            break; 
      case 17:
            XOMP_parallel_start (run_me_17, (void*) g_parameter, *numThread);
            break; 
      case 18:
            XOMP_parallel_start (run_me_18, (void*) g_parameter, *numThread);
            break; 
      case 19:
            XOMP_parallel_start (run_me_19, (void*) g_parameter, *numThread);
            break; 
      case 20:
            XOMP_parallel_start (run_me_20, (void*) g_parameter, *numThread);
            break; 
      case 21:
            XOMP_parallel_start (run_me_21, (void*) g_parameter, *numThread);
            break; 
      case 22:
            XOMP_parallel_start (run_me_22, (void*) g_parameter, *numThread);
            break; 
      case 23:
            XOMP_parallel_start (run_me_23, (void*) g_parameter, *numThread);
            break; 
      case 24:
            XOMP_parallel_start (run_me_24, (void*) g_parameter, *numThread);
            break; 
      case 25:
            XOMP_parallel_start (run_me_25, (void*) g_parameter, *numThread);
            break; 
      case 26:
            XOMP_parallel_start (run_me_26, (void*) g_parameter, *numThread);
            break; 
      case 27:
            XOMP_parallel_start (run_me_27, (void*) g_parameter, *numThread);
            break; 
      case 28:
            XOMP_parallel_start (run_me_28, (void*) g_parameter, *numThread);
            break; 
      case 29:
            XOMP_parallel_start (run_me_29, (void*) g_parameter, *numThread);
            break; 
      case 30:
            XOMP_parallel_start (run_me_30, (void*) g_parameter, *numThread);
            break; 
      case 31:
            XOMP_parallel_start (run_me_31, (void*) g_parameter, *numThread);
            break; 
      case 32:
            XOMP_parallel_start (run_me_32, (void*) g_parameter, *numThread);
            break; 
      case 33:
            XOMP_parallel_start (run_me_33, (void*) g_parameter, *numThread);
            break; 
      case 34:
            XOMP_parallel_start (run_me_34, (void*) g_parameter, *numThread);
            break; 
      case 35:
            XOMP_parallel_start (run_me_35, (void*) g_parameter, *numThread);
            break; 
      case 36:
            XOMP_parallel_start (run_me_36, (void*) g_parameter, *numThread);
            break; 
      case 37:
            XOMP_parallel_start (run_me_37, (void*) g_parameter, *numThread);
            break; 
      case 38:
            XOMP_parallel_start (run_me_38, (void*) g_parameter, *numThread);
            break; 
      case 39:
            XOMP_parallel_start (run_me_39, (void*) g_parameter, *numThread);
            break; 
      case 40:
            XOMP_parallel_start (run_me_40, (void*) g_parameter, *numThread);
            break; 
      case 41:
            XOMP_parallel_start (run_me_41, (void*) g_parameter, *numThread);
            break; 
      case 42:
            XOMP_parallel_start (run_me_42, (void*) g_parameter, *numThread);
            break; 
      case 43:
            XOMP_parallel_start (run_me_43, (void*) g_parameter, *numThread);
            break; 
      case 44:
            XOMP_parallel_start (run_me_44, (void*) g_parameter, *numThread);
            break; 
      case 45:
            XOMP_parallel_start (run_me_45, (void*) g_parameter, *numThread);
            break; 
      case 46:
            XOMP_parallel_start (run_me_46, (void*) g_parameter, *numThread);
            break; 
      case 47:
            XOMP_parallel_start (run_me_47, (void*) g_parameter, *numThread);
            break; 
      case 48:
            XOMP_parallel_start (run_me_48, (void*) g_parameter, *numThread);
            break; 
      case 49:
            XOMP_parallel_start (run_me_49, (void*) g_parameter, *numThread);
            break; 
      case 50:
            XOMP_parallel_start (run_me_50, (void*) g_parameter, *numThread);
            break; 
      case 51:
            XOMP_parallel_start (run_me_51, (void*) g_parameter, *numThread);
            break; 
      case 52:
            XOMP_parallel_start (run_me_52, (void*) g_parameter, *numThread);
            break; 
      case 53:
            XOMP_parallel_start (run_me_53, (void*) g_parameter, *numThread);
            break; 
      case 54:
            XOMP_parallel_start (run_me_54, (void*) g_parameter, *numThread);
            break; 
      case 55:
            XOMP_parallel_start (run_me_55, (void*) g_parameter, *numThread);
            break; 
      case 56:
            XOMP_parallel_start (run_me_56, (void*) g_parameter, *numThread);
            break; 
      case 57:
            XOMP_parallel_start (run_me_57, (void*) g_parameter, *numThread);
            break; 
      case 58:
            XOMP_parallel_start (run_me_58, (void*) g_parameter, *numThread);
            break; 
      case 59:
            XOMP_parallel_start (run_me_59, (void*) g_parameter, *numThread);
            break; 
      case 60:
            XOMP_parallel_start (run_me_60, (void*) g_parameter, *numThread);
            break; 
      case 61:
            XOMP_parallel_start (run_me_61, (void*) g_parameter, *numThread);
            break; 
      case 62:
            XOMP_parallel_start (run_me_62, (void*) g_parameter, *numThread);
            break; 
      case 63:
            XOMP_parallel_start (run_me_63, (void*) g_parameter, *numThread);
            break; 
      case 64:
            XOMP_parallel_start (run_me_64, (void*) g_parameter, *numThread);
            break; 
      case 65:
            XOMP_parallel_start (run_me_65, (void*) g_parameter, *numThread);
            break; 
      case 66:
            XOMP_parallel_start (run_me_66, (void*) g_parameter, *numThread);
            break; 
      case 67:
            XOMP_parallel_start (run_me_67, (void*) g_parameter, *numThread);
            break; 
      case 68:
            XOMP_parallel_start (run_me_68, (void*) g_parameter, *numThread);
            break; 
      case 69:
            XOMP_parallel_start (run_me_69, (void*) g_parameter, *numThread);
            break; 
      case 70:
            XOMP_parallel_start (run_me_70, (void*) g_parameter, *numThread);
            break; 
      case 71:
            XOMP_parallel_start (run_me_71, (void*) g_parameter, *numThread);
            break; 
      case 72:
            XOMP_parallel_start (run_me_72, (void*) g_parameter, *numThread);
            break; 
      case 73:
            XOMP_parallel_start (run_me_73, (void*) g_parameter, *numThread);
            break; 
      case 74:
            XOMP_parallel_start (run_me_74, (void*) g_parameter, *numThread);
            break; 
      case 75:
            XOMP_parallel_start (run_me_75, (void*) g_parameter, *numThread);
            break; 
      case 76:
            XOMP_parallel_start (run_me_76, (void*) g_parameter, *numThread);
            break; 
      case 77:
            XOMP_parallel_start (run_me_77, (void*) g_parameter, *numThread);
            break; 
      case 78:
            XOMP_parallel_start (run_me_78, (void*) g_parameter, *numThread);
            break; 
      case 79:
            XOMP_parallel_start (run_me_79, (void*) g_parameter, *numThread);
            break; 
      case 80:
            XOMP_parallel_start (run_me_80, (void*) g_parameter, *numThread);
            break; 
      case 81:
            XOMP_parallel_start (run_me_81, (void*) g_parameter, *numThread);
            break; 
      case 82:
            XOMP_parallel_start (run_me_82, (void*) g_parameter, *numThread);
            break; 
      case 83:
            XOMP_parallel_start (run_me_83, (void*) g_parameter, *numThread);
            break; 
      case 84:
            XOMP_parallel_start (run_me_84, (void*) g_parameter, *numThread);
            break; 
      case 85:
            XOMP_parallel_start (run_me_85, (void*) g_parameter, *numThread);
            break; 
      case 86:
            XOMP_parallel_start (run_me_86, (void*) g_parameter, *numThread);
            break; 
      case 87:
            XOMP_parallel_start (run_me_87, (void*) g_parameter, *numThread);
            break; 
      case 88:
            XOMP_parallel_start (run_me_88, (void*) g_parameter, *numThread);
            break; 
      case 89:
            XOMP_parallel_start (run_me_89, (void*) g_parameter, *numThread);
            break; 
      case 90:
            XOMP_parallel_start (run_me_90, (void*) g_parameter, *numThread);
            break; 
      case 91:
            XOMP_parallel_start (run_me_91, (void*) g_parameter, *numThread);
            break; 
      case 92:
            XOMP_parallel_start (run_me_92, (void*) g_parameter, *numThread);
            break; 
      case 93:
            XOMP_parallel_start (run_me_93, (void*) g_parameter, *numThread);
            break; 
      case 94:
            XOMP_parallel_start (run_me_94, (void*) g_parameter, *numThread);
            break; 
      case 95:
            XOMP_parallel_start (run_me_95, (void*) g_parameter, *numThread);
            break; 
      case 96:
            XOMP_parallel_start (run_me_96, (void*) g_parameter, *numThread);
            break; 
      case 97:
            XOMP_parallel_start (run_me_97, (void*) g_parameter, *numThread);
            break; 
      case 98:
            XOMP_parallel_start (run_me_98, (void*) g_parameter, *numThread);
            break; 
      case 99:
            XOMP_parallel_start (run_me_99, (void*) g_parameter, *numThread);
            break; 
      case 100:
            XOMP_parallel_start (run_me_100, (void*) g_parameter, *numThread);
            break; 
      case 101:
            XOMP_parallel_start (run_me_101, (void*) g_parameter, *numThread);
            break; 
      case 102:
            XOMP_parallel_start (run_me_102, (void*) g_parameter, *numThread);
            break; 
      case 103:
            XOMP_parallel_start (run_me_103, (void*) g_parameter, *numThread);
            break; 
      case 104:
            XOMP_parallel_start (run_me_104, (void*) g_parameter, *numThread);
            break; 
      case 105:
            XOMP_parallel_start (run_me_105, (void*) g_parameter, *numThread);
            break; 
      case 106:
            XOMP_parallel_start (run_me_106, (void*) g_parameter, *numThread);
            break; 
      case 107:
            XOMP_parallel_start (run_me_107, (void*) g_parameter, *numThread);
            break; 
      case 108:
            XOMP_parallel_start (run_me_108, (void*) g_parameter, *numThread);
            break; 
      case 109:
            XOMP_parallel_start (run_me_109, (void*) g_parameter, *numThread);
            break; 
      case 110:
            XOMP_parallel_start (run_me_110, (void*) g_parameter, *numThread);
            break; 
      case 111:
            XOMP_parallel_start (run_me_111, (void*) g_parameter, *numThread);
            break; 
      case 112:
            XOMP_parallel_start (run_me_112, (void*) g_parameter, *numThread);
            break; 
      case 113:
            XOMP_parallel_start (run_me_113, (void*) g_parameter, *numThread);
            break; 
      case 114:
            XOMP_parallel_start (run_me_114, (void*) g_parameter, *numThread);
            break; 
      case 115:
            XOMP_parallel_start (run_me_115, (void*) g_parameter, *numThread);
            break; 
      case 116:
            XOMP_parallel_start (run_me_116, (void*) g_parameter, *numThread);
            break; 
      case 117:
            XOMP_parallel_start (run_me_117, (void*) g_parameter, *numThread);
            break; 
      case 118:
            XOMP_parallel_start (run_me_118, (void*) g_parameter, *numThread);
            break; 
      case 119:
            XOMP_parallel_start (run_me_119, (void*) g_parameter, *numThread);
            break; 
      case 120:
            XOMP_parallel_start (run_me_120, (void*) g_parameter, *numThread);
            break; 
      case 121:
            XOMP_parallel_start (run_me_121, (void*) g_parameter, *numThread);
            break; 
      case 122:
            XOMP_parallel_start (run_me_122, (void*) g_parameter, *numThread);
            break; 
      case 123:
            XOMP_parallel_start (run_me_123, (void*) g_parameter, *numThread);
            break; 
      case 124:
            XOMP_parallel_start (run_me_124, (void*) g_parameter, *numThread);
            break; 
      case 125:
            XOMP_parallel_start (run_me_125, (void*) g_parameter, *numThread);
            break; 
      case 126:
            XOMP_parallel_start (run_me_126, (void*) g_parameter, *numThread);
            break; 
      case 127:
            XOMP_parallel_start (run_me_127, (void*) g_parameter, *numThread);
            break; 
      case 128:
            XOMP_parallel_start (run_me_128, (void*) g_parameter, *numThread);
            break; 
      case 129:
            XOMP_parallel_start (run_me_129, (void*) g_parameter, *numThread);
            break; 
      case 130:
            XOMP_parallel_start (run_me_130, (void*) g_parameter, *numThread);
            break; 
      case 131:
            XOMP_parallel_start (run_me_131, (void*) g_parameter, *numThread);
            break; 
      case 132:
            XOMP_parallel_start (run_me_132, (void*) g_parameter, *numThread);
            break; 
      case 133:
            XOMP_parallel_start (run_me_133, (void*) g_parameter, *numThread);
            break; 
      case 134:
            XOMP_parallel_start (run_me_134, (void*) g_parameter, *numThread);
            break; 
      case 135:
            XOMP_parallel_start (run_me_135, (void*) g_parameter, *numThread);
            break; 
      case 136:
            XOMP_parallel_start (run_me_136, (void*) g_parameter, *numThread);
            break; 
      case 137:
            XOMP_parallel_start (run_me_137, (void*) g_parameter, *numThread);
            break; 
      case 138:
            XOMP_parallel_start (run_me_138, (void*) g_parameter, *numThread);
            break; 
      case 139:
            XOMP_parallel_start (run_me_139, (void*) g_parameter, *numThread);
            break; 
      case 140:
            XOMP_parallel_start (run_me_140, (void*) g_parameter, *numThread);
            break; 
      case 141:
            XOMP_parallel_start (run_me_141, (void*) g_parameter, *numThread);
            break; 
      case 142:
            XOMP_parallel_start (run_me_142, (void*) g_parameter, *numThread);
            break; 
      case 143:
            XOMP_parallel_start (run_me_143, (void*) g_parameter, *numThread);
            break; 
      case 144:
            XOMP_parallel_start (run_me_144, (void*) g_parameter, *numThread);
            break; 
      case 145:
            XOMP_parallel_start (run_me_145, (void*) g_parameter, *numThread);
            break; 
      case 146:
            XOMP_parallel_start (run_me_146, (void*) g_parameter, *numThread);
            break; 
      case 147:
            XOMP_parallel_start (run_me_147, (void*) g_parameter, *numThread);
            break; 
      case 148:
            XOMP_parallel_start (run_me_148, (void*) g_parameter, *numThread);
            break; 
      case 149:
            XOMP_parallel_start (run_me_149, (void*) g_parameter, *numThread);
            break; 
      case 150:
            XOMP_parallel_start (run_me_150, (void*) g_parameter, *numThread);
            break; 
      case 151:
            XOMP_parallel_start (run_me_151, (void*) g_parameter, *numThread);
            break; 
      case 152:
            XOMP_parallel_start (run_me_152, (void*) g_parameter, *numThread);
            break; 
      case 153:
            XOMP_parallel_start (run_me_153, (void*) g_parameter, *numThread);
            break; 
      case 154:
            XOMP_parallel_start (run_me_154, (void*) g_parameter, *numThread);
            break; 
      case 155:
            XOMP_parallel_start (run_me_155, (void*) g_parameter, *numThread);
            break; 
      case 156:
            XOMP_parallel_start (run_me_156, (void*) g_parameter, *numThread);
            break; 
      case 157:
            XOMP_parallel_start (run_me_157, (void*) g_parameter, *numThread);
            break; 
      case 158:
            XOMP_parallel_start (run_me_158, (void*) g_parameter, *numThread);
            break; 
      case 159:
            XOMP_parallel_start (run_me_159, (void*) g_parameter, *numThread);
            break; 
      case 160:
            XOMP_parallel_start (run_me_160, (void*) g_parameter, *numThread);
            break; 
      case 161:
            XOMP_parallel_start (run_me_161, (void*) g_parameter, *numThread);
            break; 
      case 162:
            XOMP_parallel_start (run_me_162, (void*) g_parameter, *numThread);
            break; 
      case 163:
            XOMP_parallel_start (run_me_163, (void*) g_parameter, *numThread);
            break; 
      case 164:
            XOMP_parallel_start (run_me_164, (void*) g_parameter, *numThread);
            break; 
      case 165:
            XOMP_parallel_start (run_me_165, (void*) g_parameter, *numThread);
            break; 
      case 166:
            XOMP_parallel_start (run_me_166, (void*) g_parameter, *numThread);
            break; 
      case 167:
            XOMP_parallel_start (run_me_167, (void*) g_parameter, *numThread);
            break; 
      case 168:
            XOMP_parallel_start (run_me_168, (void*) g_parameter, *numThread);
            break; 
      case 169:
            XOMP_parallel_start (run_me_169, (void*) g_parameter, *numThread);
            break; 
      case 170:
            XOMP_parallel_start (run_me_170, (void*) g_parameter, *numThread);
            break; 
      case 171:
            XOMP_parallel_start (run_me_171, (void*) g_parameter, *numThread);
            break; 
      case 172:
            XOMP_parallel_start (run_me_172, (void*) g_parameter, *numThread);
            break; 
      case 173:
            XOMP_parallel_start (run_me_173, (void*) g_parameter, *numThread);
            break; 
      case 174:
            XOMP_parallel_start (run_me_174, (void*) g_parameter, *numThread);
            break; 
      case 175:
            XOMP_parallel_start (run_me_175, (void*) g_parameter, *numThread);
            break; 
      case 176:
            XOMP_parallel_start (run_me_176, (void*) g_parameter, *numThread);
            break; 
      case 177:
            XOMP_parallel_start (run_me_177, (void*) g_parameter, *numThread);
            break; 
      case 178:
            XOMP_parallel_start (run_me_178, (void*) g_parameter, *numThread);
            break; 
      case 179:
            XOMP_parallel_start (run_me_179, (void*) g_parameter, *numThread);
            break; 
      case 180:
            XOMP_parallel_start (run_me_180, (void*) g_parameter, *numThread);
            break; 
      case 181:
            XOMP_parallel_start (run_me_181, (void*) g_parameter, *numThread);
            break; 
      case 182:
            XOMP_parallel_start (run_me_182, (void*) g_parameter, *numThread);
            break; 
      case 183:
            XOMP_parallel_start (run_me_183, (void*) g_parameter, *numThread);
            break; 
      case 184:
            XOMP_parallel_start (run_me_184, (void*) g_parameter, *numThread);
            break; 
      case 185:
            XOMP_parallel_start (run_me_185, (void*) g_parameter, *numThread);
            break; 
      case 186:
            XOMP_parallel_start (run_me_186, (void*) g_parameter, *numThread);
            break; 
      case 187:
            XOMP_parallel_start (run_me_187, (void*) g_parameter, *numThread);
            break; 
      case 188:
            XOMP_parallel_start (run_me_188, (void*) g_parameter, *numThread);
            break; 
      case 189:
            XOMP_parallel_start (run_me_189, (void*) g_parameter, *numThread);
            break; 
      case 190:
            XOMP_parallel_start (run_me_190, (void*) g_parameter, *numThread);
            break; 
      case 191:
            XOMP_parallel_start (run_me_191, (void*) g_parameter, *numThread);
            break; 
      case 192:
            XOMP_parallel_start (run_me_192, (void*) g_parameter, *numThread);
            break; 
      case 193:
            XOMP_parallel_start (run_me_193, (void*) g_parameter, *numThread);
            break; 
      case 194:
            XOMP_parallel_start (run_me_194, (void*) g_parameter, *numThread);
            break; 
      case 195:
            XOMP_parallel_start (run_me_195, (void*) g_parameter, *numThread);
            break; 
      case 196:
            XOMP_parallel_start (run_me_196, (void*) g_parameter, *numThread);
            break; 
      case 197:
            XOMP_parallel_start (run_me_197, (void*) g_parameter, *numThread);
            break; 
      case 198:
            XOMP_parallel_start (run_me_198, (void*) g_parameter, *numThread);
            break; 
      case 199:
            XOMP_parallel_start (run_me_199, (void*) g_parameter, *numThread);
            break; 
      case 200:
            XOMP_parallel_start (run_me_200, (void*) g_parameter, *numThread);
            break; 
      case 201:
            XOMP_parallel_start (run_me_201, (void*) g_parameter, *numThread);
            break; 
      case 202:
            XOMP_parallel_start (run_me_202, (void*) g_parameter, *numThread);
            break; 
      case 203:
            XOMP_parallel_start (run_me_203, (void*) g_parameter, *numThread);
            break; 
      case 204:
            XOMP_parallel_start (run_me_204, (void*) g_parameter, *numThread);
            break; 
      case 205:
            XOMP_parallel_start (run_me_205, (void*) g_parameter, *numThread);
            break; 
      case 206:
            XOMP_parallel_start (run_me_206, (void*) g_parameter, *numThread);
            break; 
      case 207:
            XOMP_parallel_start (run_me_207, (void*) g_parameter, *numThread);
            break; 
      case 208:
            XOMP_parallel_start (run_me_208, (void*) g_parameter, *numThread);
            break; 
      case 209:
            XOMP_parallel_start (run_me_209, (void*) g_parameter, *numThread);
            break; 
      case 210:
            XOMP_parallel_start (run_me_210, (void*) g_parameter, *numThread);
            break; 
      case 211:
            XOMP_parallel_start (run_me_211, (void*) g_parameter, *numThread);
            break; 
      case 212:
            XOMP_parallel_start (run_me_212, (void*) g_parameter, *numThread);
            break; 
      case 213:
            XOMP_parallel_start (run_me_213, (void*) g_parameter, *numThread);
            break; 
      case 214:
            XOMP_parallel_start (run_me_214, (void*) g_parameter, *numThread);
            break; 
      case 215:
            XOMP_parallel_start (run_me_215, (void*) g_parameter, *numThread);
            break; 
      case 216:
            XOMP_parallel_start (run_me_216, (void*) g_parameter, *numThread);
            break; 
      case 217:
            XOMP_parallel_start (run_me_217, (void*) g_parameter, *numThread);
            break; 
      case 218:
            XOMP_parallel_start (run_me_218, (void*) g_parameter, *numThread);
            break; 
      case 219:
            XOMP_parallel_start (run_me_219, (void*) g_parameter, *numThread);
            break; 
      case 220:
            XOMP_parallel_start (run_me_220, (void*) g_parameter, *numThread);
            break; 
      case 221:
            XOMP_parallel_start (run_me_221, (void*) g_parameter, *numThread);
            break; 
      case 222:
            XOMP_parallel_start (run_me_222, (void*) g_parameter, *numThread);
            break; 
      case 223:
            XOMP_parallel_start (run_me_223, (void*) g_parameter, *numThread);
            break; 
      case 224:
            XOMP_parallel_start (run_me_224, (void*) g_parameter, *numThread);
            break; 
      case 225:
            XOMP_parallel_start (run_me_225, (void*) g_parameter, *numThread);
            break; 
      case 226:
            XOMP_parallel_start (run_me_226, (void*) g_parameter, *numThread);
            break; 
      case 227:
            XOMP_parallel_start (run_me_227, (void*) g_parameter, *numThread);
            break; 
      case 228:
            XOMP_parallel_start (run_me_228, (void*) g_parameter, *numThread);
            break; 
      case 229:
            XOMP_parallel_start (run_me_229, (void*) g_parameter, *numThread);
            break; 
      case 230:
            XOMP_parallel_start (run_me_230, (void*) g_parameter, *numThread);
            break; 
      case 231:
            XOMP_parallel_start (run_me_231, (void*) g_parameter, *numThread);
            break; 
      case 232:
            XOMP_parallel_start (run_me_232, (void*) g_parameter, *numThread);
            break; 
      case 233:
            XOMP_parallel_start (run_me_233, (void*) g_parameter, *numThread);
            break; 
      case 234:
            XOMP_parallel_start (run_me_234, (void*) g_parameter, *numThread);
            break; 
      case 235:
            XOMP_parallel_start (run_me_235, (void*) g_parameter, *numThread);
            break; 
      case 236:
            XOMP_parallel_start (run_me_236, (void*) g_parameter, *numThread);
            break; 
      case 237:
            XOMP_parallel_start (run_me_237, (void*) g_parameter, *numThread);
            break; 
      case 238:
            XOMP_parallel_start (run_me_238, (void*) g_parameter, *numThread);
            break; 
      case 239:
            XOMP_parallel_start (run_me_239, (void*) g_parameter, *numThread);
            break; 
      case 240:
            XOMP_parallel_start (run_me_240, (void*) g_parameter, *numThread);
            break; 
      case 241:
            XOMP_parallel_start (run_me_241, (void*) g_parameter, *numThread);
            break; 
      case 242:
            XOMP_parallel_start (run_me_242, (void*) g_parameter, *numThread);
            break; 
      case 243:
            XOMP_parallel_start (run_me_243, (void*) g_parameter, *numThread);
            break; 
      case 244:
            XOMP_parallel_start (run_me_244, (void*) g_parameter, *numThread);
            break; 
      case 245:
            XOMP_parallel_start (run_me_245, (void*) g_parameter, *numThread);
            break; 
      case 246:
            XOMP_parallel_start (run_me_246, (void*) g_parameter, *numThread);
            break; 
      case 247:
            XOMP_parallel_start (run_me_247, (void*) g_parameter, *numThread);
            break; 
      case 248:
            XOMP_parallel_start (run_me_248, (void*) g_parameter, *numThread);
            break; 
      case 249:
            XOMP_parallel_start (run_me_249, (void*) g_parameter, *numThread);
            break; 
      case 250:
            XOMP_parallel_start (run_me_250, (void*) g_parameter, *numThread);
            break; 
      case 251:
            XOMP_parallel_start (run_me_251, (void*) g_parameter, *numThread);
            break; 
      case 252:
            XOMP_parallel_start (run_me_252, (void*) g_parameter, *numThread);
            break; 
      case 253:
            XOMP_parallel_start (run_me_253, (void*) g_parameter, *numThread);
            break; 
      case 254:
            XOMP_parallel_start (run_me_254, (void*) g_parameter, *numThread);
            break; 
      case 255:
            XOMP_parallel_start (run_me_255, (void*) g_parameter, *numThread);
            break; 
      case 256:
            XOMP_parallel_start (run_me_256, (void*) g_parameter, *numThread);
            break; 
